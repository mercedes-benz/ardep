## CMakeLists.txt
```
# Copyright (C) Frickly Systems GmbH
# Copyright (C) MBition GmbH
#
# SPDX-License-Identifier: Apache-2.0

cmake_minimum_required(VERSION 3.13.1)

find_package(Zephyr REQUIRED HINTS $ENV{ZEPHYR_BASE})
project(uds_routine)

target_sources(app PRIVATE src/main.c src/iso14229_common.c src/write_memory_by_addr_impl.c)
```

## prj.conf
```kconfig
CONFIG_CAN=y
CONFIG_ISOTP=n

CONFIG_CAN_MAX_FILTER=12

CONFIG_UDS=n
# CONFIG_UDS_EXTERNAL=y

CONFIG_LOG=y
CONFIG_UDS_LOG_LEVEL_DBG=y

CONFIG_ISO14229_LIB=y
```

## src/main.c
```c
/*
 * Copyright (C) Frickly Systems GmbH
 * Copyright (C) MBition GmbH
 *
 * SPDX-License-Identifier: Apache-2.0
 */

// Use scripts/uds_iso14229_demo_script.py to test

#include "iso14229_common.h"
#include "write_memory_by_addr_impl.h"

#include <errno.h>

#include <zephyr/drivers/can.h>
#include <zephyr/kernel.h>
#include <zephyr/logging/log.h>

#include <server.h>
#include <tp/isotp_c.h>
#include <util.h>

LOG_MODULE_REGISTER(iso14229_testing, LOG_LEVEL_DBG);

static const struct device *can_dev = DEVICE_DT_GET(DT_CHOSEN(zephyr_canbus));

uint8_t dummy_memory[512] = {0x01, 0x02, 0x03, 0x04, 0x05};

struct iso14229_zephyr_instance inst;

UDSErr_t uds_cb(struct UDSServer *srv, UDSEvent_t event, void *arg) {
  LOG_DBG("UDS Event: %s", UDSEventToStr(event));
  switch (event) {
    case UDS_EVT_Err: {
      UDSErr_t *err = (UDSErr_t *)arg;
      LOG_ERR("UDS Error: %d", *err);
      break;
    }
    case UDS_EVT_DiagSessCtrl: {
      UDSDiagSessCtrlArgs_t *session_args = (UDSDiagSessCtrlArgs_t *)arg;
      LOG_INF("Diagnostic Session Control: %d", session_args->type);
      break;
    }
    case UDS_EVT_EcuReset: {
      uint8_t *reset_type = (uint8_t *)arg;
      LOG_INF("ECU Reset: %d", *reset_type);
      break;
    }
    case UDS_EVT_SessionTimeout: {
      LOG_WRN("Session Timeout");
      srv->sessionType = UDS_LEV_DS_DS;  // reset to default session
      break;
    }
    case UDS_EVT_RoutineCtrl: {
      UDSRoutineCtrlArgs_t *routine = (UDSRoutineCtrlArgs_t *)arg;
      LOG_INF("Routine Control: %d %d", routine->id, routine->ctrlType);
      // as per the standard, basically any data can be returned here
      uint8_t data = 1;
      routine->copyStatusRecord(srv, &data, 1);
      break;
    }
    case UDS_EVT_RequestDownload: {
      UDSRequestDownloadArgs_t *req = (UDSRequestDownloadArgs_t *)arg;
      LOG_INF("Request Download: addr=%p size=%zu format=%d", req->addr,
              req->size, req->dataFormatIdentifier);
      break;
    }
    case UDS_EVT_TransferData: {  //! note: very import: the first block number
                                  //! must be 1 with this library
      UDSTransferDataArgs_t *transfer_args = (UDSTransferDataArgs_t *)arg;
      LOG_HEXDUMP_INF(transfer_args->data, transfer_args->len, "Transfer Data");
      LOG_INF("Transfer Data: len=%d", transfer_args->len);
      break;
    }
    case UDS_EVT_RequestTransferExit: {
      UDSRequestTransferExitArgs_t *exit_args =
          (UDSRequestTransferExitArgs_t *)arg;
      LOG_INF("Request Transfer Exit: len=%d", exit_args->len);
      break;
    }
    case UDS_EVT_ReadMemByAddr: {
      UDSReadMemByAddrArgs_t *read_args = (UDSReadMemByAddrArgs_t *)arg;
      LOG_INF("Read Memory By Address: addr=%p size=%zu", read_args->memAddr,
              read_args->memSize);
      read_args->copy(srv, &dummy_memory[(uint32_t)read_args->memAddr],
                      read_args->memSize);
      break;
    }
    default:
      UDSCustomArgs_t *custom_args = (UDSCustomArgs_t *)arg;

      if (custom_args->sid == CUSTOMUDS_WriteMemoryByAddr_SID) {
        struct CUSTOMUDS_WriteMemoryByAddr args;
        UDSErr_t e = customuds_decode_write_memory_by_addr(custom_args, &args);
        if (e != UDS_PositiveResponse) {
          return e;
        }

        memcpy(&dummy_memory[args.addr], args.data, args.len);

        LOG_HEXDUMP_INF(args.data, args.len, "Write Memory By Address");
        LOG_INF("Write Memory By Address: addr=0x%08X len=%zu", args.addr,
                args.len);

        return customuds_answer(srv, custom_args, &args);
      }

      return UDS_NRC_ServiceNotSupported;
  }

  return UDS_OK;
}

int main(void) {
  UDSISOTpCConfig_t cfg = {
    .source_addr = 0x7E8,
    .target_addr = 0x7E0,
    .source_addr_func = 0x7DF,
    .target_addr_func = UDS_TP_NOOP_ADDR,
  };

  iso14229_zephyr_init(&inst, &cfg, can_dev, uds_cb);

  int err;
  if (!device_is_ready(can_dev)) {
    printk("CAN device not ready\n");
    return -ENODEV;
  }

  err = can_set_mode(can_dev, CAN_MODE_NORMAL);
  if (err) {
    printk("Failed to set CAN mode: %d\n", err);
    return err;
  }

  err = can_start(can_dev);
  if (err) {
    printk("Failed to start CAN device: %d\n", err);
    return err;
  }
  printk("CAN device started\n");

  while (1) {
    iso14229_zephyr_thread(&inst);
  }
}
```

## src/iso14229_common.c
```c
// This would be dedicated into a separate library
#include "iso14229_common.h"

#include <zephyr/logging/log.h>

LOG_MODULE_REGISTER(iso14229_common, LOG_LEVEL_DBG);

static void can_rx_cb(const struct device* dev,
                      struct can_frame* frame,
                      void* user_data) {
  LOG_DBG("CAN RX: %03x [%u] %x ...", frame->id, frame->dlc, frame->data[0]);
  k_msgq_put((struct k_msgq*)user_data, frame, K_NO_WAIT);
}

int iso14229_zephyr_init(struct iso14229_zephyr_instance* inst,
                         const UDSISOTpCConfig_t* iso_tp_config,
                         const struct device* can_dev,
                         UDSErr_t (*uds_cb)(struct UDSServer* srv,
                                            UDSEvent_t event,
                                            void* arg)) {
  k_msgq_init(&inst->can_phys_msgq, inst->can_phys_buffer,
              sizeof(struct can_frame), ARRAY_SIZE(inst->can_phys_buffer));

  k_msgq_init(&inst->can_func_msgq, inst->can_func_buffer,
              sizeof(struct can_frame), ARRAY_SIZE(inst->can_func_buffer));

  UDSServerInit(&inst->server);
  UDSISOTpCInit(&inst->tp, iso_tp_config);

  inst->server.fn = uds_cb;
  inst->server.tp = &inst->tp.hdl;
  inst->tp.phys_link.user_send_can_arg = (void*)can_dev;
  inst->tp.func_link.user_send_can_arg = (void*)can_dev;

  const struct can_filter phys_filter = {
    .id = inst->tp.phys_sa,
    .mask = CAN_STD_ID_MASK,
  };
  const struct can_filter func_filter = {
    .id = inst->tp.func_sa,
    .mask = CAN_STD_ID_MASK,
  };
  int err =
      can_add_rx_filter(can_dev, can_rx_cb, &inst->can_phys_msgq, &phys_filter);
  if (err < 0) {
    printk("Failed to add RX filter for physical address: %d\n", err);
    return err;
  }
  err =
      can_add_rx_filter(can_dev, can_rx_cb, &inst->can_func_msgq, &func_filter);
  if (err < 0) {
    printk("Failed to add RX filter for functional address: %d\n", err);
    return err;
  }

  return 0;
}

void iso14229_zephyr_thread(struct iso14229_zephyr_instance* inst) {
  while (1) {
    struct can_frame frame_phys;
    struct can_frame frame_func;
    int ret_phys = k_msgq_get(&inst->can_phys_msgq, &frame_phys, K_NO_WAIT);
    int ret_func = k_msgq_get(&inst->can_func_msgq, &frame_func, K_NO_WAIT);

    if (ret_phys == 0) {
      isotp_on_can_message(&inst->tp.phys_link, frame_phys.data,
                           frame_phys.dlc);
    }

    if (ret_func == 0) {
      isotp_on_can_message(&inst->tp.func_link, frame_func.data,
                           frame_func.dlc);
    }

    UDSServerPoll(&inst->server);

    k_sleep(K_MSEC(1));
  }
}
```

## src/iso14229_common.h
```c
// This would be dedicated into a separate library

#include <zephyr/drivers/can.h>
#include <zephyr/kernel.h>

#include <server.h>
#include <tp/isotp_c.h>

struct iso14229_zephyr_instance {
  UDSServer_t server;
  UDSISOTpC_t tp;

  struct k_msgq can_phys_msgq;
  struct k_msgq can_func_msgq;

  char can_phys_buffer[sizeof(struct can_frame) * 25];
  char can_func_buffer[sizeof(struct can_frame) * 25];
};

int iso14229_zephyr_init(struct iso14229_zephyr_instance* inst,
                         const UDSISOTpCConfig_t* iso_tp_config,
                         const struct device* can_dev,
                         UDSErr_t (*uds_cb)(struct UDSServer* srv,
                                            UDSEvent_t event,
                                            void* arg));
void iso14229_zephyr_thread(struct iso14229_zephyr_instance* inst);
```

## src/write_memory_by_addr_impl.h
```c
#include <server.h>

#define CUSTOMUDS_WriteMemoryByAddr_SID 0x3D

struct CUSTOMUDS_WriteMemoryByAddr {
  uint32_t addr;
  const uint8_t* data;
  size_t len;

  struct {
    uint8_t memory_addr_len;
    uint8_t memory_size_len;
  } _answer_context;
};

UDSErr_t customuds_decode_write_memory_by_addr(
    UDSCustomArgs_t* data, struct CUSTOMUDS_WriteMemoryByAddr* args);

UDSErr_t customuds_answer(UDSServer_t* srv,
                          UDSCustomArgs_t* data,
                          const struct CUSTOMUDS_WriteMemoryByAddr* args);
```
