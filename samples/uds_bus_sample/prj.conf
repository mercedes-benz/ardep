## CMakeLists.txt
```
# SPDX-FileCopyrightText: Copyright (C) Frickly Systems GmbH
# SPDX-FileCopyrightText: Copyright (C) MBition GmbH
#
# SPDX-License-Identifier: Apache-2.0

cmake_minimum_required(VERSION 3.13.1)

find_package(Zephyr REQUIRED HINTS $ENV{ZEPHYR_BASE})
project(uds_bus_sample)

file(GLOB SRC_FILES src/*.c)
target_sources(app PRIVATE ${SRC_FILES})
```

## Kconfig
```
# Copyright (C) Frickly Systems GmbH
# Copyright (C) MBition GmbH
#
# SPDX-License-Identifier: Apache-2.0

mainmenu "UDS Bus Sample"

comment "UDS Bus Sample Configuration"

menu "UDS Bus Sample Settings"

comment "UDS Addresses"

config UDS_ADDR_PHYS_SA
    hex "Physical Source Address"
    default 0x7E8
    help
      The physical source address used for UDS communication.
      Should be the same as the firmware loader's address

config UDS_ADDR_PHYS_TA
    hex "Physical Target Address"
    default 0x7E0
    help
      The physical target address used for UDS communication.
      Should be the same as the firmware loader's address

endmenu

comment "Zephyr Configuration"

source "Kconfig.zephyr"
```

## Kconfig.sysbuild
```
# Copyright (C) Frickly Systems GmbH
# Copyright (C) MBition GmbH
#
# SPDX-License-Identifier: Apache-2.0

source "share/sysbuild/Kconfig"

config UDS_BASE_ADDR
    hex "UDS Base address"
    default 0x00
    range 0x00 0x07
    help
      Base address, is added on top of the physical addresses
```

## sample.yaml
```
# Copyright (C) Frickly Systems GmbH
# Copyright (C) MBition GmbH
#
# SPDX-License-Identifier: Apache-2.0

sample:
  name: uds bus sample
common:
  build_only: true
  integration_platforms:
    - ardep
tests:
  example.uds_bus_sample.default:
    sysbuild: true
```

## sysbuild.conf
```
# force use of uds firmware loader
SB_CONFIG_BOOT_LOGIC_UDS_FIRMWARE_LOADER=y
```

## prj.conf
```kconfig
CONFIG_CAN=y

CONFIG_LOG=y
CONFIG_LOG_INFO_COLOR_GREEN=y

CONFIG_HEAP_MEM_POOL_SIZE=1024
CONFIG_STD_C17=y

CONFIG_GPIO=y

# mbedtls needs more stack
CONFIG_ISO14229_THREAD_STACK_SIZE=4096
```

## boards/native_sim.conf
```kconfig
CONFIG_SYS_CLOCK_TICKS_PER_SEC=1000

CONFIG_GPIO_EMUL=y
```

## boards/native_sim_native_64.conf
```kconfig
CONFIG_SYS_CLOCK_TICKS_PER_SEC=1000

CONFIG_NO_OPTIMIZATIONS=y
CONFIG_GPIO_EMUL=y
```

## boards/native_sim.overlay
```dts
/*
 * SPDX-FileCopyrightText: Copyright (C) Frickly Systems GmbH
 * SPDX-FileCopyrightText: Copyright (C) MBition GmbH
 *
 * SPDX-License-Identifier: Apache-2.0
 */

/ {
    chosen {
        zephyr,canbus = &can0;
    };
};

&can0 {
    status = "okay";
};
```

## boards/native_sim_native_64.overlay
```dts
/*
 * SPDX-FileCopyrightText: Copyright (C) Frickly Systems GmbH
 * SPDX-FileCopyrightText: Copyright (C) MBition GmbH
 *
 * SPDX-License-Identifier: Apache-2.0
 */

#include "native_sim.overlay"
```

## src/main.c
```c
/*
 * SPDX-FileCopyrightText: Copyright (C) Frickly Systems GmbH
 * SPDX-FileCopyrightText: Copyright (C) MBition GmbH
 *
 * SPDX-License-Identifier: Apache-2.0
 */

#include <zephyr/logging/log.h>
LOG_MODULE_REGISTER(uds_bus_sample, LOG_LEVEL_INF);

#include "uds.h"

#include <zephyr/drivers/can.h>
#include <zephyr/kernel.h>

#include <ardep/iso14229.h>
#include <ardep/uds.h>

static const struct device *can_dev = DEVICE_DT_GET(DT_CHOSEN(zephyr_canbus));

struct uds_instance_t instance;

UDS_REGISTER_ECU_DEFAULT_HARD_RESET_HANDLER(&instance);

int main(void) {
  int err;
  LOG_INF("ARDEP UDS Bus Sample");

  UDSISOTpCConfig_t cfg = {
    // Hardware Addresses
    .source_addr = CONFIG_UDS_ADDR_PHYS_SA,
    .target_addr = CONFIG_UDS_ADDR_PHYS_TA,

    // Functional Addresses
    .source_addr_func = 0x7DF,
    .target_addr_func = UDS_TP_NOOP_ADDR,
  };

  uds_init(&instance, &cfg, can_dev, NULL);

  if (!device_is_ready(can_dev)) {
    LOG_INF("CAN device not ready");
    return -ENODEV;
  }

  err = can_set_mode(can_dev, CAN_MODE_NORMAL);
  if (err) {
    LOG_ERR("Failed to set CAN mode: %d", err);
    return err;
  }

  err = can_start(can_dev);
  if (err) {
    LOG_ERR(
        "Failed to start CAN device: "
        "%d",
        err);
    return err;
  }
  LOG_INF("CAN device started");

  instance.iso14229.thread_start(&instance.iso14229);
  LOG_INF("UDS thread started");
}
```

## src/controller.c
```c
#include "uds.h"

#include <zephyr/kernel.h>
#include <zephyr/logging/log.h>

LOG_MODULE_REGISTER(controller, LOG_LEVEL_INF);

static const struct device *can_dev = DEVICE_DT_GET(DT_CHOSEN(zephyr_canbus));

#define CONTROLLER_CAN_SEND_ADDR 0x001
#define CONTROLLER_CAN_RECEIVE_ADDR 0x000
// Timeout for waiting for CAN response in milliseconds
#define CONTROLLER_CAN_TIMEOUT_MS 1000

enum controller_routine_status {
  CONTROLLER_ROUTINE_STATUS__SUCCESS = 0x00,
  CONTROLLER_ROUTINE_STATUS__ERROR = 0x01,
  CONTROLLER_ROUTINE_STATUS__NOT_COMPLETED = 0xFF,
};

struct {
  bool running;  // set at the start of the work, cleared at the end
  uint8_t routine_result[9];  // 1 byte status + 8 bytes data
} controller_routine_data;
K_MUTEX_DEFINE(controller_routine_data_mutex);

K_SEM_DEFINE(controller_receive_sem, 0, 1);

static void controller_routine_rx(const struct device *dev,
                                  struct can_frame *frame,
                                  void *user_data) {
  struct can_frame *user_data_type = user_data;
  *user_data_type = *frame;
  k_sem_give(&controller_receive_sem);
}

static void controller_routine(struct k_work *work) {
  ARG_UNUSED(work);

  k_mutex_lock(&controller_routine_data_mutex, K_FOREVER);
  controller_routine_data.running = true;
  k_mutex_unlock(&controller_routine_data_mutex);

  struct can_frame controller_received_frame;
  struct can_filter rx_filter = {
    .id = CONTROLLER_CAN_RECEIVE_ADDR,
    .mask = CAN_STD_ID_MASK,
    .flags = 0,
  };

  LOG_INF("Adding filter for controller routine");
  int filter_id = can_add_rx_filter(can_dev, controller_routine_rx,
                                    &controller_received_frame, &rx_filter);

  struct can_frame initial_frame = {
    .id = CONTROLLER_CAN_SEND_ADDR,
    .data = {0xde},
    .dlc = 1,
    .flags = 0,
  };

  LOG_INF("Sending controller routine start frame");
  int ret = can_send(can_dev, &initial_frame, K_FOREVER, NULL, NULL);
  if (ret != 0) {
    LOG_ERR("Can send returned err: %d", ret);
    k_mutex_lock(&controller_routine_data_mutex, K_FOREVER);
    controller_routine_data.routine_result[0] =
        CONTROLLER_ROUTINE_STATUS__ERROR;  // error
    controller_routine_data.running = false;
    k_mutex_unlock(&controller_routine_data_mutex);
    return;
  }

  ret = k_sem_take(&controller_receive_sem, K_MSEC(CONTROLLER_CAN_TIMEOUT_MS));

  can_remove_rx_filter(can_dev, filter_id);

  k_mutex_lock(&controller_routine_data_mutex, K_FOREVER);
  if (ret != 0) {
    controller_routine_data.routine_result[0] =
        CONTROLLER_ROUTINE_STATUS__ERROR;  // error
    LOG_ERR("Timeout waiting for cycle response");
  } else {
    controller_routine_data.routine_result[0] =
        CONTROLLER_ROUTINE_STATUS__SUCCESS;  // success
    memcpy(&controller_routine_data.routine_result[1],
           &controller_received_frame.data,
           MIN(controller_received_frame.dlc, 8));
    LOG_INF("Controller routine received %d bytes",
            controller_received_frame.dlc);
  }
  controller_routine_data.running = false;
  k_mutex_unlock(&controller_routine_data_mutex);
}

K_WORK_DEFINE(controller_routine_work, controller_routine);

static UDSErr_t async_routine_control_check(
    const struct uds_context *const context, bool *apply_action) {
  *apply_action = true;
  return UDS_OK;
}

static UDSErr_t async_routine_control_action(struct uds_context *const context,
                                             bool *consume_event) {
  UDSRoutineCtrlArgs_t *args = context->arg;

  *consume_event = true;

  switch (args->ctrlType) {
    case UDS_ROUTINE_CONTROL__START_ROUTINE: {
      // Check if work is already running
      if (k_work_is_pending(&controller_routine_work)) {
        return UDS_NRC_RequestSequenceError;
      }

      k_mutex_lock(&controller_routine_data_mutex, K_FOREVER);
      if (controller_routine_data.running) {
        k_mutex_unlock(&controller_routine_data_mutex);
        return UDS_NRC_RequestSequenceError;
      }

      controller_routine_data.routine_result[0] =
          CONTROLLER_ROUTINE_STATUS__NOT_COMPLETED;  // default to not completed
      k_mutex_unlock(&controller_routine_data_mutex);

      // Schedule the work to start immediately
      int ret = k_work_submit(&controller_routine_work);
      if (ret < 0) {
        LOG_ERR("Failed to schedule async work: %d", ret);
        return UDS_NRC_ConditionsNotCorrect;
      }

      LOG_INF("Submitted controller routine to work queue");

      // Return success status for start
      return UDS_PositiveResponse;
    }

    case UDS_ROUTINE_CONTROL__STOP_ROUTINE: {
      LOG_INF("Stopping controller routine (not supported)");
      return UDS_NRC_SubFunctionNotSupported;
    }

    case UDS_ROUTINE_CONTROL__REQUEST_ROUTINE_RESULTS: {
      uint8_t routine_result[9];  // stack-local copy of the result

      k_mutex_lock(&controller_routine_data_mutex, K_FOREVER);
      memcpy(routine_result, controller_routine_data.routine_result,
             sizeof(routine_result));
      k_mutex_unlock(&controller_routine_data_mutex);

      return args->copyStatusRecord(context->server, routine_result,
                                    sizeof(routine_result));
    }

    default:
      return UDS_NRC_SubFunctionNotSupported;
  }
}

UDS_REGISTER_ROUTINE_CONTROL_HANDLER(&instance,
                                     0x0000,
                                     async_routine_control_check,
                                     async_routine_control_action,
                                     NULL);
```

## src/diag_session_ctrl.c
```c
/*
 * SPDX-FileCopyrightText: Copyright (C) Frickly Systems GmbH
 * SPDX-FileCopyrightText: Copyright (C) MBition GmbH
 *
 * SPDX-License-Identifier: Apache-2.0
 */

#include <zephyr/logging/log.h>
LOG_MODULE_DECLARE(uds_bus_sample);

#include "uds.h"

#include <ardep/uds.h>

const struct device* retention_data =
    DEVICE_DT_GET(DT_CHOSEN(zephyr_firmware_loader_args));

UDSErr_t diag_session_ctrl_check(const struct uds_context* const context,
                                 bool* apply_action) {
  *apply_action = true;

  return UDS_OK;
}

UDSErr_t diag_session_ctrl_action(struct uds_context* const context,
                                  bool* consume_event) {
  UDSDiagSessCtrlArgs_t* args = context->arg;

  if (args->type == UDS_DIAG_SESSION__PROGRAMMING) {
    LOG_INF("Switching into firmware loader");
    return uds_switch_to_firmware_loader_with_programming_session();
  }

  LOG_INF("Changing diagnostic session to 0x%02X", args->type);

  *consume_event = false;

  return UDS_PositiveResponse;
}

UDSErr_t diag_session_timeout_check(const struct uds_context* const context,
                                    bool* apply_action) {
  *apply_action = true;
  return UDS_OK;
}

UDSErr_t diag_session_timeout_action(struct uds_context* const context,
                                     bool* consume_event) {
  LOG_INF("Diagnostic Session Timeout");
  *consume_event = false;

  return UDS_PositiveResponse;
}

UDS_REGISTER_DIAG_SESSION_CTRL_HANDLER(&instance,
                                       diag_session_ctrl_check,
                                       diag_session_ctrl_action,
                                       diag_session_timeout_check,
                                       diag_session_timeout_action,
                                       NULL)
```

## src/master_responder.c
```c
#include "uds.h"

#include <zephyr/kernel.h>
#include <zephyr/logging/log.h>
#include <zephyr/sys/byteorder.h>

LOG_MODULE_DECLARE(uds_sample);

static const struct device *can_dev = DEVICE_DT_GET(DT_CHOSEN(zephyr_canbus));

static uint16_t can_receive_addr = 0;
static uint16_t can_send_addr = 0;

int receive_can_filter_id = -1;

struct can_frame received_frame;
static void rx_cb_work_handler(struct k_work *work) {
  struct can_frame to_send = received_frame;

  if (to_send.dlc + 1 > CAN_MAX_DLC) {
    LOG_WRN(
        "Cannot append own signature to received frame, DLC would exceed %d "
        "bytes. Sending without signature.",
        CAN_MAX_DLC);
    can_send(can_dev, &to_send, K_FOREVER, NULL, NULL);
    return;
  }

  to_send.id = can_send_addr;
  to_send.dlc = received_frame.dlc + 1;

  // append a simple signature: XOR of the first byte and LSB of physical source
  // address
  to_send.data[received_frame.dlc] =
      to_send.data[0] ^ (CONFIG_UDS_ADDR_PHYS_SA & 0xff);

  can_send(can_dev, &to_send, K_FOREVER, NULL, NULL);
  LOG_INF("Sent CAN frame ID 0x%03X DLC %d", to_send.id, to_send.dlc);
  LOG_HEXDUMP_INF(to_send.data, to_send.dlc, "Sent data: ");
}

K_WORK_DEFINE(rx_cb_work, rx_cb_work_handler);

static void rx_cb(const struct device *dev,
                  struct can_frame *frame,
                  void *user_data) {
  received_frame = *frame;
  LOG_INF("Received CAN frame ID 0x%03X DLC %d", frame->id, frame->dlc);

  k_work_submit(&rx_cb_work);
}

UDSErr_t rw_data_by_id_check(const struct uds_context *const context,
                             bool *apply_action) {
  *apply_action = true;

  return UDS_OK;
}

UDSErr_t r_data_by_id_action(struct uds_context *const context,
                             bool *consume_event) {
  UDSRDBIArgs_t *args = context->arg;

  switch (args->dataId) {
    case 0x1100:
      args->copy(context->server, &can_receive_addr, sizeof(can_receive_addr));
      break;
    case 0x1101:
      args->copy(context->server, &can_send_addr, sizeof(can_send_addr));
      break;
    default:
      *consume_event = false;
      return UDS_OK;
  }

  *consume_event = true;

  return UDS_PositiveResponse;
}

UDSErr_t w_data_by_id_action(struct uds_context *const context,
                             bool *consume_event) {
  UDSWDBIArgs_t *args = context->arg;

  switch (args->dataId) {
    case 0x1100: {
      if (args->len != sizeof(can_receive_addr)) {
        return UDS_NRC_IncorrectMessageLengthOrInvalidFormat;
      }
      memcpy(&can_receive_addr, args->data, args->len);
      can_receive_addr = sys_le16_to_cpu(can_receive_addr);

      // deregister previous filter if it exists
      if (receive_can_filter_id != -1) {
        can_remove_rx_filter(can_dev, receive_can_filter_id);
      }

      // register a new filter with set address
      struct can_filter filter = {
        .flags = 0,
        .id = can_receive_addr,
        .mask = CAN_STD_ID_MASK,
      };
      receive_can_filter_id = can_add_rx_filter(can_dev, rx_cb, NULL, &filter);
      LOG_INF("Registered CAN RX filter for ID 0x%03X", can_receive_addr);

      if (receive_can_filter_id < 0) {
        LOG_ERR("Failed to register CAN RX filter");
        return UDS_NRC_ConditionsNotCorrect;
      }
    }

    break;
    case 0x1101:
      if (args->len != sizeof(can_send_addr)) {
        return UDS_NRC_IncorrectMessageLengthOrInvalidFormat;
      }
      memcpy(&can_send_addr, args->data, args->len);
      can_send_addr = sys_le16_to_cpu(can_send_addr);

      LOG_INF("Set CAN send address to 0x%03X", can_send_addr);
      break;
    default:
      *consume_event = false;
      return UDS_OK;
  }

  *consume_event = true;

  return UDS_PositiveResponse;
}

UDS_REGISTER_DATA_BY_IDENTIFIER_HANDLER(&instance,
                                        0x1100,
                                        NULL,
                                        rw_data_by_id_check,
                                        r_data_by_id_action,
                                        rw_data_by_id_check,
                                        w_data_by_id_action,
                                        NULL,
                                        NULL,
                                        NULL);
UDS_REGISTER_DATA_BY_IDENTIFIER_HANDLER(&instance,
                                        0x1101,
                                        NULL,
                                        rw_data_by_id_check,
                                        r_data_by_id_action,
                                        rw_data_by_id_check,
                                        w_data_by_id_action,
                                        NULL,
                                        NULL,
                                        NULL);
```

## src/master_routine.c
```c
#include "uds.h"

#include <zephyr/kernel.h>
#include <zephyr/logging/log.h>

LOG_MODULE_DECLARE(uds_sample);

static const struct device *can_dev = DEVICE_DT_GET(DT_CHOSEN(zephyr_canbus));

#define MASTER_CAN_SEND_ADDR 0x001
#define MASTER_CAN_RECEIVE_ADDR 0x000
#define MASTER_CAN_TIMEOUT_MS 1000

enum master_routine_status {
  MASTER_ROUTINE_STATUS__SUCCESS = 0x00,
  MASTER_ROUTINE_STATUS__ERROR = 0x01,
  MASTER_ROUTINE_STATUS__NOT_COMPLETED = 0xFF,
};

struct {
  bool running;  // set at the start of the work, cleared at the end
  uint8_t routine_result[9];  // 1 byte status + 8 bytes data
} master_routine_data;
K_MUTEX_DEFINE(master_routine_data_mutex);

K_SEM_DEFINE(master_receive_sem, 0, 1);

static void master_routine_rx(const struct device *dev,
                              struct can_frame *frame,
                              void *user_data) {
  struct can_frame *user_data_type = user_data;
  *user_data_type = *frame;
  k_sem_give(&master_receive_sem);
}

static void master_routine(struct k_work *work) {
  ARG_UNUSED(work);

  k_mutex_lock(&master_routine_data_mutex, K_FOREVER);
  master_routine_data.running = true;
  k_mutex_unlock(&master_routine_data_mutex);

  struct can_frame master_received_frame;
  struct can_filter rx_filter = {
    .id = MASTER_CAN_RECEIVE_ADDR,
    .mask = CAN_STD_ID_MASK,
    .flags = 0,
  };

  LOG_INF("Adding filter for master routine");
  int filter_id = can_add_rx_filter(can_dev, master_routine_rx,
                                    &master_received_frame, &rx_filter);

  struct can_frame initial_frame = {
    .id = MASTER_CAN_SEND_ADDR,
    .data = {0xde},
    .dlc = 1,
    .flags = 0,
  };

  LOG_INF("Sending master routine start frame");
  int ret = can_send(can_dev, &initial_frame, K_FOREVER, NULL, NULL);
  if (ret != 0) {
    LOG_ERR("Can send returned err: %d", ret);
    k_mutex_lock(&master_routine_data_mutex, K_FOREVER);
    master_routine_data.routine_result[0] =
        MASTER_ROUTINE_STATUS__ERROR;  // error
    master_routine_data.running = false;
    k_mutex_unlock(&master_routine_data_mutex);
    return;
  }

  ret = k_sem_take(&master_receive_sem, K_MSEC(MASTER_CAN_TIMEOUT_MS));

  can_remove_rx_filter(can_dev, filter_id);

  k_mutex_lock(&master_routine_data_mutex, K_FOREVER);
  if (ret != 0) {
    master_routine_data.routine_result[0] =
        MASTER_ROUTINE_STATUS__ERROR;  // error
    LOG_ERR("Timeout waiting for cycle response");
  } else {
    master_routine_data.routine_result[0] =
        MASTER_ROUTINE_STATUS__SUCCESS;  // success
    memcpy(&master_routine_data.routine_result[1], &master_received_frame.data,
           MIN(master_received_frame.dlc, 8));
    LOG_INF("Master routine received %d bytes", master_received_frame.dlc);
  }
  master_routine_data.running = false;
  k_mutex_unlock(&master_routine_data_mutex);
}

K_WORK_DEFINE(master_routine_work, master_routine);

static UDSErr_t async_routine_control_check(
    const struct uds_context *const context, bool *apply_action) {
  *apply_action = true;
  return UDS_OK;
}

static UDSErr_t async_routine_control_action(struct uds_context *const context,
                                             bool *consume_event) {
  UDSRoutineCtrlArgs_t *args = context->arg;
  // struct uds_async_routine_data *data =
  //     context->registration->routine_control.user_context;

  *consume_event = true;

  switch (args->ctrlType) {
    case UDS_ROUTINE_CONTROL__START_ROUTINE: {
      // Check if work is already running
      if (k_work_is_pending(&master_routine_work)) {
        return UDS_NRC_RequestSequenceError;
      }

      k_mutex_lock(&master_routine_data_mutex, K_FOREVER);
      if (master_routine_data.running) {
        k_mutex_unlock(&master_routine_data_mutex);
        return UDS_NRC_RequestSequenceError;
      }

      master_routine_data.routine_result[0] =
          MASTER_ROUTINE_STATUS__NOT_COMPLETED;  // default to not completed
      k_mutex_unlock(&master_routine_data_mutex);

      // Schedule the work to start immediately
      int ret = k_work_submit(&master_routine_work);
      if (ret < 0) {
        LOG_ERR("Failed to schedule async work: %d", ret);
        return UDS_NRC_ConditionsNotCorrect;
      }

      LOG_INF("Submitted master routine to work queue");

      // Return success status for start
      return UDS_PositiveResponse;
    }

    case UDS_ROUTINE_CONTROL__STOP_ROUTINE: {
      LOG_INF("Stopping master routine (not supported)");
      return UDS_NRC_SubFunctionNotSupported;
    }

    case UDS_ROUTINE_CONTROL__REQUEST_ROUTINE_RESULTS: {
      k_mutex_lock(&master_routine_data_mutex, K_FOREVER);
      uint8_t routine_result[9];
      memcpy(routine_result, master_routine_data.routine_result,
             sizeof(routine_result));
      k_mutex_unlock(&master_routine_data_mutex);

      return args->copyStatusRecord(context->server, routine_result,
                                    sizeof(routine_result));
    }

    default:
      return UDS_NRC_SubFunctionNotSupported;
  }
}

UDS_REGISTER_ROUTINE_CONTROL_HANDLER(&instance,
                                     0x0000,
                                     async_routine_control_check,
                                     async_routine_control_action,
                                     NULL);
```

## src/uds.h
```c
/*
 * SPDX-FileCopyrightText: Copyright (C) Frickly Systems GmbH
 * SPDX-FileCopyrightText: Copyright (C) MBition GmbH
 *
 * SPDX-License-Identifier: Apache-2.0
 */

#ifndef ARDEP_SAMPLES_UDS_BUS_SAMPLE_SRC_UDS_H
#define ARDEP_SAMPLES_UDS_BUS_SAMPLE_SRC_UDS_H

#include <ardep/uds.h>

extern struct uds_instance_t instance;

#endif  // ARDEP_SAMPLES_UDS_BUS_SAMPLE_SRC_UDS_H
```

## src/worker.c
```c
#include "uds.h"

#include <zephyr/kernel.h>
#include <zephyr/logging/log.h>
#include <zephyr/sys/byteorder.h>

LOG_MODULE_REGISTER(worker, LOG_LEVEL_INF);

static const struct device *can_dev = DEVICE_DT_GET(DT_CHOSEN(zephyr_canbus));

// addresses set via UDS data identifer (note that the write handler registers a
// can rx filter callback)
static uint16_t can_receive_addr = 0;
static uint16_t can_send_addr = 0;

// id of the can rx filter for can_receive_addr. -1 if none was created (yet)
static int receive_can_filter_id = -1;

// the received can frame before the work was queued
static struct can_frame received_can_frame;

static void can_rx_cb_work_handler(struct k_work *work) {
  struct can_frame to_send = received_can_frame;

  if (to_send.dlc + 1 > CAN_MAX_DLC) {
    LOG_WRN(
        "Cannot append own signature to received frame, DLC would exceed %d "
        "bytes. Sending without signature.",
        CAN_MAX_DLC);
    can_send(can_dev, &to_send, K_FOREVER, NULL, NULL);
    return;
  }

  to_send.id = can_send_addr;
  to_send.dlc = received_can_frame.dlc + 1;

  // append a simple signature: XOR of the first byte and LSB of physical source
  // address
  to_send.data[received_can_frame.dlc] =
      to_send.data[0] ^ (CONFIG_UDS_ADDR_PHYS_SA & 0xff);

  int err = can_send(can_dev, &to_send, K_FOREVER, NULL, NULL);
  if (err) {
    LOG_ERR("Failed to send CAN frame: %d", err);
    return;
  }

  LOG_INF("Sent CAN frame ID 0x%03X DLC %d", to_send.id, to_send.dlc);
  LOG_HEXDUMP_INF(to_send.data, to_send.dlc, "Sent data: ");
}

K_WORK_DEFINE(can_rx_cb_work, can_rx_cb_work_handler);

static void can_rx_cb(const struct device *dev,
                      struct can_frame *frame,
                      void *user_data) {
  LOG_INF("Received CAN frame ID 0x%03X DLC %d", frame->id, frame->dlc);

  received_can_frame = *frame;
  k_work_submit(&can_rx_cb_work);
}

static UDSErr_t rw_data_by_id_check(const struct uds_context *const context,
                                    bool *apply_action) {
  *apply_action = true;

  return UDS_OK;
}

static UDSErr_t r_data_by_id_action(struct uds_context *const context,
                                    bool *consume_event) {
  UDSRDBIArgs_t *args = context->arg;

  switch (args->dataId) {
    case 0x1100:
      args->copy(context->server, &can_receive_addr, sizeof(can_receive_addr));
      break;
    case 0x1101:
      args->copy(context->server, &can_send_addr, sizeof(can_send_addr));
      break;
    default:
      *consume_event = false;
      return UDS_OK;
  }

  *consume_event = true;

  return UDS_PositiveResponse;
}

static UDSErr_t w_data_by_id_action(struct uds_context *const context,
                                    bool *consume_event) {
  UDSWDBIArgs_t *args = context->arg;

  switch (args->dataId) {
    case 0x1100: {
      if (args->len != sizeof(can_receive_addr)) {
        return UDS_NRC_IncorrectMessageLengthOrInvalidFormat;
      }
      memcpy(&can_receive_addr, args->data, args->len);
      can_receive_addr = sys_le16_to_cpu(can_receive_addr);

      // deregister previous filter if it exists
      if (receive_can_filter_id != -1) {
        can_remove_rx_filter(can_dev, receive_can_filter_id);
      }

      // register a new filter with set address
      struct can_filter filter = {
        .flags = 0,
        .id = can_receive_addr,
        .mask = CAN_STD_ID_MASK,
      };
      receive_can_filter_id =
          can_add_rx_filter(can_dev, can_rx_cb, NULL, &filter);
      LOG_INF("Registered CAN RX filter for ID 0x%03X", can_receive_addr);

      if (receive_can_filter_id < 0) {
        LOG_ERR("Failed to register CAN RX filter");
        return UDS_NRC_ConditionsNotCorrect;
      }
    }

    break;
    case 0x1101:
      if (args->len != sizeof(can_send_addr)) {
        return UDS_NRC_IncorrectMessageLengthOrInvalidFormat;
      }
      memcpy(&can_send_addr, args->data, args->len);
      can_send_addr = sys_le16_to_cpu(can_send_addr);

      LOG_INF("Set CAN send address to 0x%03X", can_send_addr);
      break;
    default:
      *consume_event = false;
      return UDS_OK;
  }

  *consume_event = true;

  return UDS_PositiveResponse;
}

UDS_REGISTER_DATA_BY_IDENTIFIER_HANDLER(&instance,
                                        0x1100,
                                        NULL,
                                        rw_data_by_id_check,
                                        r_data_by_id_action,
                                        rw_data_by_id_check,
                                        w_data_by_id_action,
                                        NULL,
                                        NULL,
                                        NULL);
UDS_REGISTER_DATA_BY_IDENTIFIER_HANDLER(&instance,
                                        0x1101,
                                        NULL,
                                        rw_data_by_id_check,
                                        r_data_by_id_action,
                                        rw_data_by_id_check,
                                        w_data_by_id_action,
                                        NULL,
                                        NULL,
                                        NULL);
```
