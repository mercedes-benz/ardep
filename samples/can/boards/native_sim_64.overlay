

fdcan1: &can0 {
    status = "okay";
    bitrate = <500000>;
};

/ {
    fdcan2: can2 {
        status = "okay";
        compatible = "zephyr,native-posix-linux-can";
        host-interface = "zcan0";
        sample-point = <875>;
        bitrate = <500000>;
    };
};
