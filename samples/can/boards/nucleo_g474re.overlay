
// set the bus speed to 500kbit/s and the data speed to 2Mbit/s
can_a: &fdcan1 {
    bitrate = <500000>;
    bitrate-data = <2000000>;
    status = "okay";
};

can_b: &fdcan2 {
    pinctrl-0 = <&fdcan2_rx_pb5 &fdcan2_tx_pb6>;
    pinctrl-names = "default";
    bitrate = <500000>;
    bitrate-data = <2000000>;
    status = "okay";
};
