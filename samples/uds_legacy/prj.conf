## CMakeLists.txt
```
# SPDX-FileCopyrightText: Copyright (C) Frickly Systems GmbH
# SPDX-FileCopyrightText: Copyright (C) MBition GmbH
#
# SPDX-License-Identifier: Apache-2.0

cmake_minimum_required(VERSION 3.13.1)

find_package(Zephyr REQUIRED HINTS $ENV{ZEPHYR_BASE})
project(uds_legacy)

target_sources(app PRIVATE src/main.c)
```

## sample.yaml
```
# Copyright (C) Frickly Systems GmbH
# Copyright (C) MBition GmbH

sample:
  name: uds legacy example
common:
  build_only: true
  integration_platforms:
    - ardep
tests:
  example.uds_legacy.default: {}
```

## prj.conf
```kconfig
CONFIG_CAN=y
CONFIG_ISOTP=y

CONFIG_FLASH=y
CONFIG_STREAM_FLASH=y
CONFIG_IMG_MANAGER=y
CONFIG_REBOOT=y
CONFIG_UDS_LEGACY=y
CONFIG_UDS=n
CONFIG_ISO14229=n

CONFIG_LOG=y
CONFIG_UDS_LEGACY_LOG_LEVEL_DBG=y
```

## src/main.c
```c
/*
 * SPDX-FileCopyrightText: Copyright (C) Frickly Systems GmbH
 * SPDX-FileCopyrightText: Copyright (C) MBition GmbH
 *
 * SPDX-License-Identifier: Apache-2.0
 */

#include <zephyr/kernel.h>

#ifndef CONFIG_UDS_LEGACY
#error "This sample requires the UDS_LEGACY config option to be enabled."
#endif

int main(void) { printk("Hello UDS_LEGACY!\n"); }
```
