## CMakeLists.txt
```
# SPDX-FileCopyrightText: Copyright (C) Frickly Systems GmbH
# SPDX-FileCopyrightText: Copyright (C) MBition GmbH
#
# SPDX-License-Identifier: Apache-2.0

cmake_minimum_required(VERSION 3.20.0)
find_package(Zephyr REQUIRED HINTS $ENV{ZEPHYR_BASE})
project(lin2can-isotp)

target_sources(app PRIVATE src/main.c src/scheduler.c)
```

## sample.yaml
```
# Copyright (C) Frickly Systems GmbH
# Copyright (C) MBition GmbH

sample:
  description: Send data back and forward
  name: lin2can_isotp_sample
common:
  build_only: true
  integration_platforms:
    - ardep
tests:
  example.lin2can_isotp_sample.default: {}
```

## prj.conf
```kconfig
CONFIG_LOG=y
CONFIG_LOG_INFO_COLOR_GREEN=y

CONFIG_LIN=y
CONFIG_CAN=y

CONFIG_ABSTRACT_LIN=y
CONFIG_ABSTRACT_LIN_SCHEDULER=y

CONFIG_LIN2CAN=y
CONFIG_ISOTP=y
CONFIG_ISOTP_RX_SF_FF_BUF_COUNT=2

CONFIG_UDS=n

CONFIG_ABSTRACT_LIN_LOG_LEVEL_OFF=y
CONFIG_LIN_LOG_LEVEL_OFF=y
```

## commander.overlay
```dts
/*
 * SPDX-FileCopyrightText: Copyright (C) Frickly Systems GmbH
 * SPDX-FileCopyrightText: Copyright (C) MBition GmbH
 *
 * SPDX-License-Identifier: Apache-2.0
 */

&abstract_lin0 {
  type = "LIN_MODE_COMMANDER";
};

&gpiob {
  lin_commander_enable: lin_commander_enable {
    gpio-hog;
    gpios = <9 GPIO_ACTIVE_HIGH>;
    output-high;
  };
};
```

## src/main.c
```c
/*
 * SPDX-FileCopyrightText: Copyright (C) Frickly Systems GmbH
 * SPDX-FileCopyrightText: Copyright (C) MBition GmbH
 *
 * SPDX-License-Identifier: Apache-2.0
 */

#include <zephyr/canbus/isotp.h>
#include <zephyr/kernel.h>
#include <zephyr/logging/log.h>

LOG_MODULE_REGISTER(main, LOG_LEVEL_INF);

const struct device *can_dev = DEVICE_DT_GET(DT_CHOSEN(zephyr_canbus));

const struct isotp_fc_opts fc_opts = {.bs = 8, .stmin = 0};
const struct isotp_msg_id rx_addr = {
  .std_id = 0x80,
};
const struct isotp_msg_id tx_addr = {
  .std_id = 0x180,
};

struct isotp_recv_ctx recv_ctx;
struct isotp_send_ctx send_ctx;

K_SEM_DEFINE(can_ready_sem, 0, 1);

const char tx_data[] =
    "Lorem ipsum dolor sit amet, consetetur sadipscing elitr, sed diam nonumy "
    "eirmod tempor invidunt ut labore et dolore magna aliquyam erat, sed diam "
    "voluptua. At vero eos et accusam et justo duo dolores et ea rebum. Stet "
    "clita kasd gubergren, no sea takimata sanctus est Lorem ipsum dolor sit "
    "amet. Lorem ipsum dolor sit amet, consetetur sadipscing elitr, sed diam "
    "nonumy eirmod tempor invidunt ut labore et dolore magna aliquyam erat, "
    "sed diam voluptua. At vero eos et accusam et justo duo dolores et ea "
    "rebum. Stet clita kasd gubergren, no sea takimata sanctus est Lorem ipsum "
    "dolor sit amet.\n\n";

void receiver_thread(void *arg1, void *arg2, void *arg3) {
  k_sem_take(&can_ready_sem, K_FOREVER);

  struct net_buf *buf;

  int err =
      isotp_bind(&recv_ctx, can_dev, &tx_addr, &rx_addr, &fc_opts, K_FOREVER);
  if (err != ISOTP_N_OK) {
    LOG_ERR("Failed to bind isotp (%d)", err);
    return;
  }

  int remaining;
  int received;
  while (1) {
    received = 0;
    do {
      remaining = isotp_recv_net(&recv_ctx, &buf, K_MSEC(2000));
      if (remaining < 0) {
        LOG_ERR("Receiving error (%d)", remaining);
        break;
      }

      while (buf != NULL) {
        received += buf->len;
        printk("%.*s", buf->len, buf->data);
        buf = net_buf_frag_del(NULL, buf);
      }
    } while (remaining);
    LOG_INF("Got %d bytes in total", received);
  }
}

K_THREAD_DEFINE(
    receiver_thread_h, 2048, receiver_thread, NULL, NULL, NULL, 5, 0, 0);

int main(void) {
  int err = 0;

  if (!device_is_ready(can_dev)) {
    LOG_ERR("CAN not ready");
    return 0;
  }

  err = can_set_mode(can_dev, 0);
  if (err != 0) {
    LOG_ERR("Failed to set mode (%d)", err);
    return 0;
  }

  err = can_start(can_dev);
  if (err != 0) {
    LOG_ERR("Error starting CAN (%d)", err);
    return 0;
  }

  k_sem_give(&can_ready_sem);

  LOG_INF("Starting to send data");

  while (1) {
    k_msleep(1000);

    err = isotp_send(&send_ctx, can_dev, tx_data, sizeof(tx_data), &tx_addr,
                     &rx_addr, NULL, NULL);
    if (err != ISOTP_N_OK) {
      printk("Error while sending data (%d)\n", err);
    }
  }
}
```

## src/scheduler.c
```c
/*
 * SPDX-FileCopyrightText: Copyright (C) Frickly Systems GmbH
 * SPDX-FileCopyrightText: Copyright (C) MBition GmbH
 *
 * SPDX-License-Identifier: Apache-2.0
 */

#include <ardep/drivers/lin_scheduler.h>

// Note: the responder doesn't need the scheduler but it is simpler to use to
// just let that be here

static const struct device *lin = DEVICE_DT_GET(DT_NODELABEL(abstract_lin0));

static const struct abstract_lin_schedule_table_t table_def = {
  .count = 2,
  .entries =
      {
        {0x3D, K_MSEC(25)},
        {0x3C, K_MSEC(25)},
      },
};

static const struct abstract_lin_schedule_table_t *tables[] = {
  &table_def,
};

ABSTRACT_LIN_REGISTER_SCHEDULER_INITIAL_TABLE(lin, scheduler_def, tables, 0);
```
