## CMakeLists.txt
```
# SPDX-FileCopyrightText: Copyright (C) Frickly Systems GmbH
# SPDX-FileCopyrightText: Copyright (C) MBition GmbH
#
# SPDX-License-Identifier: Apache-2.0

cmake_minimum_required(VERSION 3.20.0)
find_package(Zephyr REQUIRED HINTS $ENV{ZEPHYR_BASE})
project(lin2can-gateway)

target_sources(app PRIVATE src/main.c)
```

## sample.yaml
```
# Copyright (C) Frickly Systems GmbH
# Copyright (C) MBition GmbH

sample:
  description: Forward can frames to lin and back
  name: lin2can_gateway_sample
common:
  build_only: true
  integration_platforms:
    - ardep
tests:
  example.lin2can_gateway_sample.default: {}
```

## prj.conf
```kconfig
CONFIG_LOG=y
CONFIG_LIN_LOG_LEVEL_DBG=y
CONFIG_LOG_INFO_COLOR_GREEN=y

CONFIG_LIN=y
CONFIG_CAN=y

CONFIG_ABSTRACT_LIN=y
CONFIG_ABSTRACT_LIN_SCHEDULER=y

CONFIG_LIN2CAN=y

CONFIG_CAN_ROUTER=y

CONFIG_UDS=n
```

## boards/ardep.overlay
```dts
&abstract_lin0 {
	type = "LIN_MODE_COMMANDER";
};

&gpiob {
	lin_commander_enable: lin_commander_enable {
		gpio-hog;
		gpios = <9 GPIO_ACTIVE_HIGH>;
		output-high;
	};
};
```

## src/main.c
```c
/*
 * SPDX-FileCopyrightText: Copyright (C) Frickly Systems GmbH
 * SPDX-FileCopyrightText: Copyright (C) MBition GmbH
 *
 * SPDX-License-Identifier: Apache-2.0
 */

#include <zephyr/device.h>
#include <zephyr/devicetree.h>
#include <zephyr/drivers/can.h>

#include <ardep/can_router.h>
#include <ardep/drivers/lin_scheduler.h>

static const struct device *can_a = DEVICE_DT_GET(DT_NODELABEL(can_a));
static const struct device *lincan = DEVICE_DT_GET(DT_NODELABEL(lin2can0));
static const struct device *lin = DEVICE_DT_GET(DT_NODELABEL(abstract_lin0));

// Router
static const struct can_router_entry_t entries[] = {
  {
    .from = &can_a,
    .to = &lincan,
    .filter =
        {
          // catch all
          .flags = 0,
          .id = 0,
          .mask = 0,
        },
  },
  {
    .from = &lincan,
    .to = &can_a,
    .filter =
        {
          // catch all
          .flags = 0,
          .id = 0,
          .mask = 0,
        },
  },
};

CAN_ROUTER_REGISTER(entries);

// Scheduler
static const struct abstract_lin_schedule_table_t table_def = {
  .count = 2,
  .entries =
      {
        {0x3D, K_MSEC(5)},
        {0x3C, K_MSEC(5)},
      },
};

static const struct abstract_lin_schedule_table_t *tables[] = {
  &table_def,
};

ABSTRACT_LIN_REGISTER_SCHEDULER_INITIAL_TABLE(lin, scheduler_def, tables, 0);

int main(void) {
  int ret = can_start(can_a);

  if (ret) {
    printk("can_start failed (%d)\n", ret);
    return ret;
  }

  printk("Hello world, CAN Router!\n");
}
```
