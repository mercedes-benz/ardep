## CMakeLists.txt
```
# SPDX-FileCopyrightText: Copyright (C) Frickly Systems GmbH
# SPDX-FileCopyrightText: Copyright (C) MBition GmbH
#
# SPDX-License-Identifier: Apache-2.0

cmake_minimum_required(VERSION 3.13.1)

find_package(Zephyr REQUIRED HINTS $ENV{ZEPHYR_BASE})
project(lin2can-uds)

target_sources(app PRIVATE src/main.c)
```

## prj.conf
```kconfig
CONFIG_CAN=y

CONFIG_LIN=y
CONFIG_ABSTRACT_LIN=y
CONFIG_LIN2CAN=y

CONFIG_ISOTP=y
CONFIG_UDS=y

CONFIG_LOG=y
CONFIG_UDS_LOG_LEVEL_DBG=y
```

## boards/ardep.overlay
```dts
/*
 * SPDX-FileCopyrightText: Copyright (C) Frickly Systems GmbH
 * SPDX-FileCopyrightText: Copyright (C) MBition GmbH
 *
 * SPDX-License-Identifier: Apache-2.0
 */

/ {
  chosen {
    zephyr,canbus = &lin2can0;
  };
};
```

## src/main.c
```c
/*
 * SPDX-FileCopyrightText: Copyright (C) Frickly Systems GmbH
 * SPDX-FileCopyrightText: Copyright (C) MBition GmbH
 *
 * SPDX-License-Identifier: Apache-2.0
 */

#include <zephyr/kernel.h>

#if !CONFIG_UDS
#error "This sample requires UDS"
#endif

int main(void) { printk("Hello UDS!\n"); }
```
