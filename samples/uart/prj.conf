## CMakeLists.txt
```
# SPDX-FileCopyrightText: Copyright (C) Frickly Systems GmbH
# SPDX-FileCopyrightText: Copyright (C) MBition GmbH
#
# SPDX-License-Identifier: Apache-2.0

cmake_minimum_required(VERSION 3.20.0)
find_package(Zephyr REQUIRED HINTS $ENV{ZEPHYR_BASE})
project(uart)

target_sources(app PRIVATE src/main.c)
```

## sample.yaml
```
# Copyright (C) Frickly Systems GmbH
# Copyright (C) MBition GmbH

sample:
  name: uart example
common:
  build_only: true
  integration_platforms:
    - nucleo_g474re
    - ardep
tests:
  example.uart.default: {}
```

## prj.conf
```kconfig
CONFIG_CONSOLE_SUBSYS=y
CONFIG_CONSOLE_GETLINE=y
CONFIG_CBPRINTF_FP_SUPPORT=y
```

## boards/ardep.overlay
```dts
/*
 * SPDX-FileCopyrightText: Copyright (C) Frickly Systems GmbH
 * SPDX-FileCopyrightText: Copyright (C) MBition GmbH
 *
 * SPDX-License-Identifier: Apache-2.0
 */

/ {
    chosen {
        // use the uart, instead of the usb serial
        zephyr,console = &uart_a;
    };
};
```

## boards/gpio_extender.overlay
```dts
/ {
    chosen {
        // use the uart, instead of the usb serial
        zephyr,console = &uart_a;
    };
};
```

## src/main.c
```c
/*
 * SPDX-FileCopyrightText: Copyright (C) Frickly Systems GmbH
 * SPDX-FileCopyrightText: Copyright (C) MBition GmbH
 *
 * SPDX-License-Identifier: Apache-2.0
 */

#include <stdlib.h>

#include <zephyr/console/console.h>
#include <zephyr/kernel.h>

int main(void) {
  console_getline_init();

  while (true) {
    printk("Enter a number:\n");

    char *s = console_getline();

    double d = strtod(s, NULL);

    printk("The square of your number: %f\n", d * d);
  }

  return 0;
}
```
