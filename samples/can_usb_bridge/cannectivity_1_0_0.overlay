/*
 * Copyright (C) Frickly Systems GmbH
 * Copyright (C) MBition GmbH
 *
 * SPDX-License-Identifier: Apache-2.0
 */

/ {
	// Redirect console to UART A
	chosen {
		zephyr,console = &uart_a;
		zephyr,shell-uart = &uart_a;
	};
};