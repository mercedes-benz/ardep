## CMakeLists.txt
```
# SPDX-FileCopyrightText: Copyright (C) Frickly Systems GmbH
# SPDX-FileCopyrightText: Copyright (C) MBition GmbH
#
# SPDX-License-Identifier: Apache-2.0

cmake_minimum_required(VERSION 3.20.0)

find_package(Zephyr REQUIRED HINTS $ENV{ZEPHYR_BASE})
project(firmware_loader)

file(GLOB SRC_FILES src/*.c)
target_sources(app PRIVATE ${SRC_FILES})
```

## Kconfig
```
# Copyright (C) Frickly Systems GmbH
# Copyright (C) MBition GmbH
#
# SPDX-License-Identifier: Apache-2.0

mainmenu "Firmware Loader"

comment "UDS Firmware Loader Configuration"

menu "Firmware Loader Settings"

module = APP
module-str = app
source "subsys/logging/Kconfig.template.log_config"

if !UDS_DEFAULT_INSTANCE_EXTERNAL_ADDRESS_PROVIDER

# alias configs for easier access of UDS_DEFAULT_INSTANCE addresses

config FIRMWARE_LOADER_PHYS_SA
    hex "Physical Source Address"
    default 0x7E8
    help
      The physical source address used for UDS communication.
      Should be the same as the main application's address

config FIRMWARE_LOADER_PHYS_TA
    hex "Physical Target Address"
    default 0x7E0
    help
      The physical target address used for UDS communication.
      Should be the same as the main application's address

config FIRMWARE_LOADER_FUNC_SA
    hex "Functional Source Address"
    default 0x7DF
    help
      The functional source address used for UDS communication.
      Should be the same as the main application's address

config UDS_DEFAULT_INSTANCE_SOURCE_ADDRESS
  default FIRMWARE_LOADER_PHYS_SA

config UDS_DEFAULT_INSTANCE_TARGET_ADDRESS
  default FIRMWARE_LOADER_PHYS_TA

config UDS_DEFAULT_INSTANCE_FUNCTIONAL_SOURCE_ADDRESS
  default FIRMWARE_LOADER_FUNC_SA

endif

config DISABLE_WAIT_BEFORE_ERASE
    bool "Disable waiting before erasing slot0"
    default n
    help
      Disables the 150ms wait before erasing slot0, which also disallows using the
      RoutineControl message without the no-reponse setting.

menuconfig FIRMWARE_LOADER_USB_DFU
    bool "Enable USB DFU support"
    default y
    select USBD_DFU
    select USB_DEVICE_STACK_NEXT
    select USBD_DFU_FLASH
    select USBD_DFU_FLASH_SLOT0
    help
      Enable USB Device Firmware Upgrade (DFU) support for firmware updates via USB.

if FIRMWARE_LOADER_USB_DFU
  config FIRMWARE_LOADER_USB_DFU_REBOOT_AFTER_COMPLETION
      bool "Reboot after DFU completion"
      default y
      depends on REBOOT
      help
        Reboot the system automatically after a successful firmware update via USB DFU.
  if FIRMWARE_LOADER_USB_DFU_REBOOT_AFTER_COMPLETION
    config FIRMWARE_LOADER_USB_DFU_REBOOT_DELAY_MS
        int "USB DFU Reboot Delay (ms)"
        default 3000
        help
          Time in milliseconds to wait before rebooting the system after a successful
          firmware update via USB DFU.
  endif
endif


endmenu

comment "Zephyr Configuration"

source "Kconfig.zephyr"
```

## prj.conf
```kconfig
# Disable the main application's USB stack (firmware loader has its own USB DFU)
CONFIG_ARDEP_USB=n

# Console and UART configuration
CONFIG_CONSOLE=y
CONFIG_SERIAL=y
CONFIG_UART_CONSOLE=y

# Logging configuration
CONFIG_LOG=y
CONFIG_LOG_DEFAULT_LEVEL=3
CONFIG_APP_LOG_LEVEL_INF=y
CONFIG_LOG_MODE_DEFERRED=y

# UDS
CONFIG_CAN=y
CONFIG_UDS=y
CONFIG_STD_C17=y
CONFIG_UDS_LOG_LEVEL_DBG=y

CONFIG_UDS_UPLOAD_DOWNLOAD_MODULE=y
# Disabled to prevent re-switching to firmware loader
CONFIG_UDS_DEFAULT_INSTANCE_DISABLE_SWITCH_TO_FIRMWARE_LOADER=y

CONFIG_ISO14229_THREAD_STACK_SIZE=2048
CONFIG_ISO14229_THREAD_SLEEP_US=1500

# Flash configuration (required for firmware download)
CONFIG_FLASH=y
CONFIG_FLASH_MAP=y
CONFIG_FLASH_PAGE_LAYOUT=y
CONFIG_STREAM_FLASH=y
CONFIG_IMG_MANAGER=y
CONFIG_IMG_ERASE_PROGRESSIVELY=y
CONFIG_REBOOT=y

# MPU configuration to protect code execution during flash write
CONFIG_ARM_MPU=y

CONFIG_USBD_DFU_FLASH_SLOT1=n
CONFIG_MCUBOOT_IMG_MANAGER=y
```

## boards/ardep.overlay
```dts
/*
 * SPDX-FileCopyrightText: Copyright (C) 2025 Frickly Systems GmbH
 * SPDX-FileCopyrightText: Copyright (C) 2025 MBition GmbH
 *
 * SPDX-License-Identifier: Apache-2.0
 */

/ {
    chosen {
      zephyr,code-partition = &slot1_partition;
      zephyr,console = &uart_a;
      zephyr,shell-uart = &uart_a;
  };
};
```

## src/main.c
```c
/*
 * SPDX-FileCopyrightText: Copyright (C) Frickly Systems GmbH
 * SPDX-FileCopyrightText: Copyright (C) MBition GmbH
 *
 * SPDX-License-Identifier: Apache-2.0
 */

#include <zephyr/logging/log.h>
LOG_MODULE_REGISTER(firmware_loader, CONFIG_APP_LOG_LEVEL);

#include "uds.h"

#include <zephyr/device.h>
#include <zephyr/kernel.h>
#include <zephyr/logging/log.h>
#include <zephyr/retention/retention.h>

#include <ardep/iso14229.h>
#include <ardep/uds.h>

const struct device *retention_data =
    DEVICE_DT_GET(DT_CHOSEN(zephyr_firmware_loader_args));

const struct device *can_dev = DEVICE_DT_GET(DT_CHOSEN(zephyr_canbus));

struct uds_instance_t instance;

UDS_REGISTER_ECU_DEFAULT_HARD_RESET_HANDLER(&instance);

int main() {
  LOG_INF("Hello firmware-loader");

  // load stored session type
  uint8_t session_type;
  int ret = retention_read(retention_data, 0, &session_type, 1);
  if (ret != 0) {
    LOG_ERR("Failed to read from retention 1: %d", ret);
    return ret;
  }
  LOG_INF("Read stored session type from retention data: %02x", session_type);

  // reset session type in storage to prevent reboot-loops
  const uint8_t reset_session_type = UDS_DIAG_SESSION__DEFAULT;
  ret = retention_write(retention_data, 0, &reset_session_type, 1);
  if (ret != 0) {
    LOG_ERR("Failed to write to retention 1: %d", ret);
    return ret;
  }

  LOG_INF("Configuring UDS...");

  UDSISOTpCConfig_t cfg = {
    // Hardware Addresses
    .source_addr = CONFIG_FIRMWARE_LOADER_PHYS_SA,
    .target_addr = CONFIG_FIRMWARE_LOADER_PHYS_TA,

    // Functional Addresses
    .source_addr_func = CONFIG_FIRMWARE_LOADER_FUNC_SA,
    .target_addr_func = UDS_TP_NOOP_ADDR,
  };

  uds_init(&instance, &cfg, can_dev, NULL);

  if (!device_is_ready(can_dev)) {
    LOG_INF("CAN device not ready");
    return -ENODEV;
  }

  int err = can_set_mode(can_dev, CAN_MODE_NORMAL);
  if (err) {
    LOG_ERR("Failed to set CAN mode: %d", err);
    return err;
  }

  if (session_type == UDS_DIAG_SESSION__PROGRAMMING) {
    LOG_INF("Injecting DiagnosticSessionControl (Programming) frame");
    struct can_frame frame = {
      .id = cfg.source_addr,
      .dlc = 3,
      .flags = 0,
    };
    frame.data[0] = 0x02;  // PCI (single frame, 2 bytes of data)
    frame.data[1] = 0x10;  // SID (DiagnosticSessionControl)
    frame.data[2] = 0x02;  // DS  (Programming Session)

    iso14229_inject_can_frame_rx(&instance.iso14229, &frame);
  }

  err = can_start(can_dev);
  if (err) {
    LOG_ERR(
        "Failed to start CAN device: "
        "%d",
        err);
    return err;
  }
  LOG_INF("CAN device started");

  instance.iso14229.thread_start(&instance.iso14229);
  LOG_INF("UDS thread started");
}
```

## src/uds_routine_control.c
```c
/*
 * SPDX-FileCopyrightText: Copyright (C) Frickly Systems GmbH
 * SPDX-FileCopyrightText: Copyright (C) MBition GmbH
 *
 * SPDX-License-Identifier: Apache-2.0
 */

#include "iso14229.h"

#include <zephyr/logging/log.h>
LOG_MODULE_DECLARE(firmware_loader, CONFIG_APP_LOG_LEVEL);

#include <zephyr/init.h>
#include <zephyr/kernel.h>
#include <zephyr/storage/flash_map.h>
#include <zephyr/sys/byteorder.h>
#include <zephyr/sys/reboot.h>
#include <zephyr/sys/util.h>

#include <ardep/uds.h>

enum uds_memory_erasure_routine_state {
  UDS_MEMORY_ERASURE_STATE__NOT_STARTED = 0,
  UDS_MEMORY_ERASURE_STATE__IN_PROGRESS = 1,
  UDS_MEMORY_ERASURE_STATE__COMPLETED = 2,
};

struct uds_memory_erasure_routine_status {
  enum uds_memory_erasure_routine_state state;
  struct k_mutex *mutex;
  int32_t result;
  struct k_work_delayable work;
};

K_MUTEX_DEFINE(memory_erasure_routine_mutex);

static void erase_slot0_work_handler(struct k_work *work);

static struct uds_memory_erasure_routine_status erasure_status = {
  .state = UDS_MEMORY_ERASURE_STATE__NOT_STARTED,
  .result = UDS_OK,
  .mutex = &memory_erasure_routine_mutex,
};

static int erase_memory_routine_init(void) {
  k_work_init_delayable(&erasure_status.work, erase_slot0_work_handler);
  return 0;
}

SYS_INIT(erase_memory_routine_init,
         APPLICATION,
         CONFIG_APPLICATION_INIT_PRIORITY);

static void erase_slot0_work_handler(struct k_work *work) {
  struct k_work_delayable *dwork = k_work_delayable_from_work(work);
  struct uds_memory_erasure_routine_status *status =
      CONTAINER_OF(dwork, struct uds_memory_erasure_routine_status, work);

  const struct flash_area *fa;
  int rc = flash_area_open(PARTITION_ID(slot0_partition), &fa);

  int32_t result = UDS_OK;

  if (rc < 0) {
    LOG_ERR("Failed to open slot0 partition: %d", rc);
    result = UDS_NRC_GeneralProgrammingFailure;
  } else {
    LOG_INF("Erasing slot0 partition at 0x%08x, size: %zu bytes",
            (uint32_t)fa->fa_off, fa->fa_size);

    rc = flash_area_erase(fa, 0, fa->fa_size);

    if (rc < 0) {
      LOG_ERR("Failed to erase slot0 partition: %d", rc);
    } else {
      LOG_INF("Successfully erased slot0 partition");
    }

    flash_area_close(fa);
  }

  k_mutex_lock(status->mutex, K_FOREVER);
  status->result = result;
  status->state = UDS_MEMORY_ERASURE_STATE__COMPLETED;
  k_mutex_unlock(status->mutex);
}

UDSErr_t erase_memory_routine_check(const struct uds_context *const context,
                                    bool *apply_action) {
  UDSRoutineCtrlArgs_t *args = (UDSRoutineCtrlArgs_t *)context->arg;

  struct uds_memory_erasure_routine_status *status =
      (struct uds_memory_erasure_routine_status *)
          context->registration->routine_control.user_context;

  if (args->ctrlType == UDS_ROUTINE_CONTROL__START_ROUTINE &&
      status->state == UDS_MEMORY_ERASURE_STATE__IN_PROGRESS) {
    LOG_WRN("Memory erasure routine already in progress");
    *apply_action = false;
    return UDS_NRC_RequestSequenceError;
  }

  if (args->ctrlType == UDS_ROUTINE_CONTROL__REQUEST_ROUTINE_RESULTS &&
      status->state != UDS_MEMORY_ERASURE_STATE__COMPLETED) {
    LOG_WRN("Memory erasure routine not completed yet");
    *apply_action = false;
    return UDS_NRC_RequestSequenceError;
  }

  if (args->ctrlType == UDS_ROUTINE_CONTROL__STOP_ROUTINE) {
    *apply_action = false;
    LOG_WRN("Stop routine not supported");
    return UDS_NRC_SubFunctionNotSupported;
  }

  *apply_action = true;
  return UDS_OK;
}

UDSErr_t erase_memory_routine_action(struct uds_context *const context,
                                     bool *consume_event) {
  UDSRoutineCtrlArgs_t *args = (UDSRoutineCtrlArgs_t *)context->arg;

  struct uds_memory_erasure_routine_status *status =
      (struct uds_memory_erasure_routine_status *)
          context->registration->routine_control.user_context;

  *consume_event = true;

  // only support flash erase for now
  if (args->id != 0xFF00) {
    LOG_WRN("Unsupported routine ID: 0x%04x", args->id);
    *consume_event = false;
    return UDS_NRC_RequestOutOfRange;
  }

  switch (args->ctrlType) {
    case UDS_ROUTINE_CONTROL__START_ROUTINE: {
      k_mutex_lock(status->mutex, K_FOREVER);
      status->state = UDS_MEMORY_ERASURE_STATE__IN_PROGRESS;
      status->result = UDS_OK;
      k_mutex_unlock(status->mutex);

#ifdef CONFIG_DISABLE_WAIT_BEFORE_ERASE
      k_work_schedule(&status->work, K_NO_WAIT);
#else
      // Submit the work item to erase slot0 with a 150ms delay
      // So the response (if requested) can be sent first
      k_work_schedule(&status->work, K_MSEC(150));
#endif

      LOG_INF("Memory erasure routine started");
      return UDS_PositiveResponse;
    }
    case UDS_ROUTINE_CONTROL__REQUEST_ROUTINE_RESULTS: {
      k_mutex_lock(status->mutex, K_FOREVER);
      enum uds_memory_erasure_routine_state current_state = status->state;
      int32_t result = status->result;
      k_mutex_unlock(status->mutex);

      if (current_state != UDS_MEMORY_ERASURE_STATE__COMPLETED) {
        LOG_WRN("Memory erasure routine not completed yet");
        return UDS_NRC_RequestSequenceError;
      }
      LOG_INF("Memory erasure routine requested result: 0x%02x", result);

      int32_t be_result = sys_cpu_to_be32(result);
      return args->copyStatusRecord(context->server, &be_result,
                                    sizeof(be_result));
    }
    default:
      LOG_WRN("Unsupported control type: 0x%02x", args->ctrlType);
      *consume_event = false;
      return UDS_NRC_SubFunctionNotSupported;
  }
}

UDS_REGISTER_ROUTINE_CONTROL_HANDLER(&uds_default_instance,
                                     0xFF00,
                                     erase_memory_routine_check,
                                     erase_memory_routine_action,
                                     &erasure_status);
```

## src/usb_dfu.c
```c
/*
 * SPDX-FileCopyrightText: Copyright (C) Frickly Systems GmbH
 * SPDX-FileCopyrightText: Copyright (C) MBition GmbH
 *
 * SPDX-License-Identifier: Apache-2.0
 */

#if defined(CONFIG_FIRMWARE_LOADER_USB_DFU)

#include <zephyr/logging/log.h>
#include <zephyr/sys/reboot.h>
#include <zephyr/usb/usbd.h>

LOG_MODULE_REGISTER(firmware_loader_usb, LOG_LEVEL_INF);

USBD_DEVICE_DEFINE(ardep_usb_dfu,
                   DEVICE_DT_GET(DT_NODELABEL(zephyr_udc0)),
                   0x25e1,
                   0x1b1e);

USBD_DESC_LANG_DEFINE(ardep_usb_dfu_lang);

USBD_DESC_MANUFACTURER_DEFINE(ardep_usb_dfu_mfr, "Mercedes-Benz AG");
USBD_DESC_PRODUCT_DEFINE(ardep_usb_dfu_product, "ARDEP USB DFU");

USBD_DESC_CONFIG_DEFINE(fs_cfg_desc, "DFU FS Configuration");
USBD_DESC_CONFIG_DEFINE(hs_cfg_desc, "DFU HS Configuration");

/* Full speed configuration */
USBD_CONFIGURATION_DEFINE(sample_fs_config, 0, 100, &fs_cfg_desc);
USBD_CONFIGURATION_DEFINE(sample_hs_config, 0, 100, &hs_cfg_desc);

#if defined(CONFIG_FIRMWARE_LOADER_USB_DFU_REBOOT_AFTER_COMPLETION)
static void reset_work_handler(struct k_work *work) {
  LOG_INF("Rebooting system to apply firmware update");
  k_msleep(CONFIG_FIRMWARE_LOADER_USB_DFU_REBOOT_DELAY_MS);
  sys_reboot(SYS_REBOOT_COLD);
}

K_WORK_DEFINE(reset_work, reset_work_handler);
#endif

static int firmware_loader_usb_init();

static void msg_cb(struct usbd_context *const usbd_ctx,
                   const struct usbd_msg *const msg) {
  switch (msg->type) {
    case USBD_MSG_DFU_APP_DETACH:
      LOG_INF("DFU Detach command received, reiniting DFU USB device");
      usbd_disable(usbd_ctx);
      usbd_shutdown(usbd_ctx);

      firmware_loader_usb_init();
      break;

#if defined(CONFIG_FIRMWARE_LOADER_USB_DFU_REBOOT_AFTER_COMPLETION)
    case USBD_MSG_DFU_DOWNLOAD_COMPLETED:
      k_work_submit(&reset_work);
      break;
#endif

    default:
      break;
  }
}

static int firmware_loader_usb_init() {
  int err;

  err = usbd_add_descriptor(&ardep_usb_dfu, &ardep_usb_dfu_lang);
  if (err) {
    LOG_ERR("Failed to add language descriptor: %d", err);
    return err;
  }

  err = usbd_add_descriptor(&ardep_usb_dfu, &ardep_usb_dfu_mfr);
  if (err) {
    LOG_ERR("Failed to add manufacturer descriptor: %d", err);
    return err;
  }

  err = usbd_add_descriptor(&ardep_usb_dfu, &ardep_usb_dfu_product);
  if (err) {
    LOG_ERR("Failed to add product descriptor: %d", err);
    return err;
  }

  if (usbd_caps_speed(&ardep_usb_dfu) == USBD_SPEED_HS) {
    err = usbd_add_configuration(&ardep_usb_dfu, USBD_SPEED_HS,
                                 &sample_hs_config);
    if (err) {
      LOG_ERR("Failed to add High-Speed configuration: %d", err);
      return err;
    }

    err = usbd_register_class(&ardep_usb_dfu, "dfu_dfu", USBD_SPEED_HS, 1);
    if (err) {
      LOG_ERR("Failed to register classes: %d", err);
      return err;
    }

    usbd_device_set_code_triple(&ardep_usb_dfu, USBD_SPEED_HS, 0, 0, 0);
  }

  err =
      usbd_add_configuration(&ardep_usb_dfu, USBD_SPEED_FS, &sample_fs_config);
  if (err) {
    LOG_ERR("Failed to add Full-Speed configuration: %d", err);
    return err;
  }

  err = usbd_register_class(&ardep_usb_dfu, "dfu_dfu", USBD_SPEED_FS, 1);
  if (err) {
    LOG_ERR("Failed to register classes: %d", err);
    return err;
  }

  usbd_device_set_code_triple(&ardep_usb_dfu, USBD_SPEED_FS, 0, 0, 0);

  err = usbd_init(&ardep_usb_dfu);
  if (err) {
    LOG_ERR("Failed to initialize usb device: %d", err);
    return err;
  }

  err = usbd_msg_register_cb(&ardep_usb_dfu, msg_cb);
  if (err) {
    LOG_ERR("Failed to register message callback: %d", err);
    return err;
  }

  err = usbd_enable(&ardep_usb_dfu);
  if (err) {
    LOG_ERR("Failed to enable usb device: %d", err);
    return err;
  }

  return 0;
}

SYS_INIT(firmware_loader_usb_init,
         APPLICATION,
         CONFIG_APPLICATION_INIT_PRIORITY);

#endif
```
