## CMakeLists.txt
```
# SPDX-FileCopyrightText: Copyright (C) Frickly Systems GmbH
# SPDX-FileCopyrightText: Copyright (C) MBition GmbH
#
# SPDX-License-Identifier: Apache-2.0

cmake_minimum_required(VERSION 3.20.0)

find_package(Zephyr REQUIRED HINTS $ENV{ZEPHYR_BASE})

project(test_uds)

FILE(GLOB app_sources src/*.c)
target_sources(app PRIVATE ${app_sources})
```

## prj.conf
```kconfig
CONFIG_ZTEST=y
CONFIG_ASSERT=y
CONFIG_CAN_FAKE=y
CONFIG_CAN=y

CONFIG_UDS=y
CONFIG_UDS_DEFAULT_INSTANCE=n
CONFIG_UDS_USE_DYNAMIC_REGISTRATION=y
CONFIG_UDS_USE_LINK_CONTROL=y

CONFIG_LOG=y
CONFIG_LOG_INFO_COLOR_GREEN=y
CONFIG_CAN_LOG=n

# Enable heap allocation for k_malloc
CONFIG_HEAP_MEM_POOL_SIZE=1024
CONFIG_STD_C17=y

# Filesystem support for UDS file transfer tests
CONFIG_FILE_SYSTEM=y
CONFIG_FILE_SYSTEM_LITTLEFS=y
CONFIG_FLASH_MAP=y
CONFIG_FLASH_PAGE_LAYOUT=y
CONFIG_FS_LOG_LEVEL_OFF=y # do not clutter test output with FS logs
```

## boards/nucleo_g474re.conf
```kconfig
CONFIG_ZTEST_STACK_SIZE=8192
```

## boards/native_sim.overlay
```dts
/*
 * SPDX-FileCopyrightText: Copyright (C) Frickly Systems GmbH
 * SPDX-FileCopyrightText: Copyright (C) MBition GmbH
 *
 * SPDX-License-Identifier: Apache-2.0
 */

/ {
	can_fake: can_fake {
		compatible = "zephyr,fake-can";
		status = "okay";
	};

	chosen {
		zephyr,canbus = &can_fake;
	};
};

&flash0{
	write-block-size = <4>;
};

/delete-node/ &can0;
```

## boards/nucleo_g474re.overlay
```dts
/*
 * SPDX-FileCopyrightText: Copyright (C) Frickly Systems GmbH
 * SPDX-FileCopyrightText: Copyright (C) MBition GmbH
 *
 * SPDX-License-Identifier: Apache-2.0
 */

/ {
	can_fake: can_fake {
		compatible = "zephyr,fake-can";
		status = "okay";
	};
	
	chosen {
		zephyr,canbus = &can_fake;
	};
};
```

## src/main.c
```c
/*
 * Copyright (C) Frickly Systems GmbH
 * Copyright (C) MBition GmbH
 *
 * SPDX-License-Identifier: Apache-2.0
 */
```

## src/dynamic_registration.c
```c
/*
 * SPDX-FileCopyrightText: Copyright (C) Frickly Systems GmbH
 * SPDX-FileCopyrightText: Copyright (C) MBition GmbH
 *
 * SPDX-License-Identifier: Apache-2.0
 */

#include "fixture.h"
#include "iso14229.h"

#include <zephyr/ztest.h>

#ifdef CONFIG_UDS_USE_DYNAMIC_REGISTRATION

#define UDS_DYNAMIC_DATA_ID_1 0xABCD
#define UDS_DYNAMIC_DATA_ID_2 0x1234

// Global counters to track invocations
static bool dynamic_reg1_check_invoked = false;
static bool dynamic_reg1_action_invoked = false;
static bool dynamic_reg2_check_invoked = false;
static bool dynamic_reg2_action_invoked = false;
static bool dynamic_reg1_unregister_invoked = false;

static void reset_global_counters(void) {
  dynamic_reg1_check_invoked = false;
  dynamic_reg1_action_invoked = false;
  dynamic_reg2_check_invoked = false;
  dynamic_reg2_action_invoked = false;
  dynamic_reg1_unregister_invoked = false;
}

static UDSErr_t receive_rdbid_event(struct uds_instance_t *instance,
                                    UDSRDBIArgs_t *args) {
  return receive_event(instance, UDS_EVT_ReadDataByIdent, args);
}

UDSErr_t custom_check_for_dynamic_reg1(const struct uds_context *const context,
                                       bool *apply_action) {
  UDSRDBIArgs_t *args = context->arg;
  if (context->registration->type == UDS_REGISTRATION_TYPE__DATA_IDENTIFIER &&
      context->registration->data_identifier.data_id == args->dataId &&
      context->event == UDS_EVT_ReadDataByIdent) {
    dynamic_reg1_check_invoked = true;
    *apply_action = true;
  }
  return UDS_OK;
}

UDSErr_t custom_action_for_dynamic_reg1(struct uds_context *const context,
                                        bool *consume_event) {
  UDSRDBIArgs_t *args = context->arg;
  if (context->registration->type == UDS_REGISTRATION_TYPE__DATA_IDENTIFIER &&
      context->registration->data_identifier.data_id == args->dataId &&
      context->event == UDS_EVT_ReadDataByIdent) {
    dynamic_reg1_action_invoked = true;
    // Don't consume event to allow further handlers to run
    *consume_event = false;
  }
  return UDS_OK;
}

UDSErr_t custom_check_for_dynamic_reg2(const struct uds_context *const context,
                                       bool *apply_action) {
  UDSRDBIArgs_t *args = context->arg;
  if (context->registration->type == UDS_REGISTRATION_TYPE__DATA_IDENTIFIER &&
      context->registration->data_identifier.data_id == args->dataId &&
      context->event == UDS_EVT_ReadDataByIdent) {
    dynamic_reg2_check_invoked = true;
    *apply_action = true;
  }
  return UDS_OK;
}

UDSErr_t custom_action_for_dynamic_reg2(struct uds_context *const context,
                                        bool *consume_event) {
  UDSRDBIArgs_t *args = context->arg;
  if (context->registration->type == UDS_REGISTRATION_TYPE__DATA_IDENTIFIER &&
      context->registration->data_identifier.data_id == args->dataId &&
      context->event == UDS_EVT_ReadDataByIdent) {
    dynamic_reg2_action_invoked = true;
    // Don't consume event to allow further handlers to run
    *consume_event = false;
  }
  return UDS_OK;
}

int custom_unregister_for_dynamic_reg1(
    struct uds_registration_t *registration) {
  dynamic_reg1_unregister_invoked = true;
  return 0;
}

ZTEST_F(lib_uds, test_two_dynamic_registration) {
  struct uds_instance_t *instance = fixture->instance;

  reset_global_counters();

  // Create first dynamic registration
  struct uds_registration_t reg1;
  reg1.type = UDS_REGISTRATION_TYPE__DATA_IDENTIFIER;
  reg1.data_identifier.data_id = UDS_DYNAMIC_DATA_ID_1;
  reg1.data_identifier.read.check = custom_check_for_dynamic_reg1;
  reg1.data_identifier.read.action = custom_action_for_dynamic_reg1;
  reg1.data_identifier.write.check = NULL;
  reg1.data_identifier.write.action = NULL;
  reg1.data_identifier.io_control.check = NULL;
  reg1.data_identifier.io_control.action = NULL;
  reg1.unregister_registration_fn = custom_unregister_for_dynamic_reg1;

  uint32_t dynamic_id_1;
  int ret =
      instance->register_event_handler(instance, reg1, &dynamic_id_1, NULL);
  zassert_ok(ret);

  // Create second dynamic registration
  struct uds_registration_t reg2;
  reg2.type = UDS_REGISTRATION_TYPE__DATA_IDENTIFIER;
  reg2.data_identifier.data_id = UDS_DYNAMIC_DATA_ID_2;
  reg2.data_identifier.read.check = custom_check_for_dynamic_reg2;
  reg2.data_identifier.read.action = custom_action_for_dynamic_reg2;
  reg2.data_identifier.write.check = NULL;
  reg2.data_identifier.write.action = NULL;
  reg2.data_identifier.io_control.check = NULL;
  reg2.data_identifier.io_control.action = NULL;
  reg2.unregister_registration_fn = NULL;

  uint32_t dynamic_id_2;
  ret = instance->register_event_handler(instance, reg2, &dynamic_id_2, NULL);
  zassert_ok(ret);

  // Test first dynamic registration
  UDSRDBIArgs_t arg1 = {
    .dataId = UDS_DYNAMIC_DATA_ID_1,
    .copy = copy,
  };

  ret = receive_rdbid_event(instance, &arg1);
  zassert_ok(ret);

  // Verify first registration was called
  zassert_true(dynamic_reg1_check_invoked,
               "First dynamic registration check should be invoked");
  zassert_true(dynamic_reg1_action_invoked,
               "First dynamic registration action should be invoked");
  zassert_false(dynamic_reg2_check_invoked,
                "Second dynamic registration check should not be invoked yet");
  zassert_false(dynamic_reg2_action_invoked,
                "Second dynamic registration action should not be invoked yet");

  reset_global_counters();

  // Test second dynamic registration
  UDSRDBIArgs_t arg2 = {
    .dataId = UDS_DYNAMIC_DATA_ID_2,
    .copy = copy,
  };

  ret = receive_rdbid_event(instance, &arg2);
  zassert_ok(ret);

  // Verify second registration was called
  zassert_false(dynamic_reg1_check_invoked,
                "First dynamic registration check should not be invoked");
  zassert_false(dynamic_reg1_action_invoked,
                "First dynamic registration action should not be invoked");
  zassert_true(dynamic_reg2_check_invoked,
               "Second dynamic registration check should be invoked");
  zassert_true(dynamic_reg2_action_invoked,
               "Second dynamic registration action should be invoked");

  reset_global_counters();

  ret = instance->unregister_event_handler(instance, dynamic_id_1);
  zassert_ok(ret);

  // Verify custom unregister function was called
  zassert_true(dynamic_reg1_unregister_invoked,
               "Custom unregister function should be invoked");

  ret = receive_rdbid_event(instance, &arg1);
  zassert_equal(ret, UDS_NRC_RequestOutOfRange);

  zassert_false(dynamic_reg1_check_invoked,
                "First dynamic registration check should not be invoked");
  zassert_false(dynamic_reg1_action_invoked,
                "First dynamic registration action should not be invoked");
  zassert_false(dynamic_reg2_check_invoked,
                "Second dynamic registration check should not be invoked");
  zassert_false(dynamic_reg2_action_invoked,
                "Second dynamic registration action should not be invoked");

  reset_global_counters();

  ret = instance->unregister_event_handler(instance, dynamic_id_2);
  zassert_ok(ret);

  ret = receive_rdbid_event(instance, &arg2);
  zassert_equal(ret, UDS_NRC_RequestOutOfRange);

  zassert_false(dynamic_reg1_check_invoked,
                "First dynamic registration check should not be invoked");
  zassert_false(dynamic_reg1_action_invoked,
                "First dynamic registration action should not be invoked");
  zassert_false(dynamic_reg2_check_invoked,
                "Second dynamic registration check should not be invoked");
  zassert_false(dynamic_reg2_action_invoked,
                "Second dynamic registration action should not be invoked");

  reset_global_counters();
}

ZTEST_F(lib_uds, test_unregistering_non_existing_registration) {
  struct uds_instance_t *instance = fixture->instance;

  uint32_t reg_id = 0xFFFFFFFF;
  int ret = instance->unregister_event_handler(instance, reg_id);
  zassert_equal(ret, -ENOENT);
}

#endif  // CONFIG_UDS_USE_DYNAMIC_REGISTRATION
```

## src/fixture.c
```c
/*
 * SPDX-FileCopyrightText: Copyright (C) Frickly Systems GmbH
 * SPDX-FileCopyrightText: Copyright (C) MBition GmbH
 *
 * SPDX-License-Identifier: Apache-2.0
 */

#include "ardep/uds_macro.h"
#include "fixture.h"
#include "iso14229.h"

#include <string.h>

#include <zephyr/drivers/can.h>
#include <zephyr/drivers/can/can_fake.h>
#include <zephyr/fs/fs.h>
#include <zephyr/fs/littlefs.h>
#include <zephyr/storage/flash_map.h>
#include <zephyr/ztest.h>

#include <errno.h>

DEFINE_FFF_GLOBALS;

DEFINE_FAKE_VALUE_FUNC(uint8_t, copy, UDSServer_t *, const void *, uint16_t);

DEFINE_FAKE_VALUE_FUNC(uint8_t, set_auth_state, UDSServer_t *, uint8_t);

DEFINE_FAKE_VALUE_FUNC(UDSErr_t,
                       data_id_check_fn,
                       const struct uds_context *const,
                       bool *);

DEFINE_FAKE_VALUE_FUNC(UDSErr_t,
                       data_id_action_fn,
                       struct uds_context *const,
                       bool *);

DEFINE_FAKE_VALUE_FUNC(UDSErr_t,
                       catchall_check_fn,
                       const struct uds_context *const,
                       bool *);

DEFINE_FAKE_VALUE_FUNC(UDSErr_t,
                       catchall_action_fn,
                       struct uds_context *const,
                       bool *);

#define FFF_FAKES_LIST(FAKE) \
  FAKE(copy)                 \
  FAKE(set_auth_state)       \
  FAKE(data_id_check_fn)     \
  FAKE(data_id_action_fn)    \
  FAKE(catchall_check_fn)    \
  FAKE(catchall_action_fn)

struct uds_instance_t fixture_uds_instance;

#ifdef CONFIG_UDS_USE_DYNAMIC_REGISTRATION
bool test_dynamic_registration_check_invoked;
bool test_dynamic_registration_action_invoked;
#endif  // # CONFIG_UDS_USE_DYNAMIC_REGISTRATION

const uint16_t data_id_r = 1;
uint8_t data_id_r_data[4];

const uint16_t data_id_rw = 2;
uint8_t data_id_rw_data[4];

const uint16_t data_id_rw_duplicated1 = 3;
const uint16_t data_id_rw_duplicated2 = 3;
uint8_t data_id_rw_duplicated_data[4];

const uint16_t routine_id = 0xDEAD;

// A data identifier that has no dedicated handler registered, used to verify
// the catch-all data identifier handler is invoked for unknown DIDs.
const uint16_t data_id_unregistered = 0xABCD;

UDS_REGISTER_DATA_BY_IDENTIFIER_HANDLER(&fixture_uds_instance,
                                        data_id_r,
                                        data_id_r_data,
                                        // read
                                        data_id_check_fn,
                                        data_id_action_fn,
                                        // write
                                        NULL,
                                        NULL,
                                        // io control
                                        NULL,
                                        NULL,
                                        NULL)

UDS_REGISTER_DATA_BY_IDENTIFIER_HANDLER(&fixture_uds_instance,
                                        data_id_rw,
                                        data_id_rw_data,
                                        // read
                                        data_id_check_fn,
                                        data_id_action_fn,
                                        // write
                                        data_id_check_fn,
                                        data_id_action_fn,
                                        // io control
                                        data_id_check_fn,
                                        data_id_action_fn,
                                        NULL)

// Duplicated Registratin for the same data ID
UDS_REGISTER_DATA_BY_IDENTIFIER_HANDLER(&fixture_uds_instance,
                                        data_id_rw_duplicated1,
                                        data_id_rw_duplicated_data,
                                        // read
                                        data_id_check_fn,
                                        data_id_action_fn,
                                        // write
                                        data_id_check_fn,
                                        data_id_action_fn,
                                        // io control
                                        data_id_check_fn,
                                        data_id_action_fn,
                                        NULL)

UDS_REGISTER_DATA_BY_IDENTIFIER_HANDLER(&fixture_uds_instance,
                                        data_id_rw_duplicated2,
                                        data_id_rw_duplicated_data,
                                        // read
                                        data_id_check_fn,
                                        data_id_action_fn,
                                        // write
                                        data_id_check_fn,
                                        data_id_action_fn,
                                        // io control
                                        data_id_check_fn,
                                        data_id_action_fn,
                                        NULL)

// Catch-all handler: receives read/write/io-control events for every DID
UDS_REGISTER_DATA_BY_IDENTIFIER_CATCHALL_HANDLER(&fixture_uds_instance,
                                                 NULL,
                                                 // read
                                                 catchall_check_fn,
                                                 catchall_action_fn,
                                                 // write
                                                 catchall_check_fn,
                                                 catchall_action_fn,
                                                 // io control
                                                 catchall_check_fn,
                                                 catchall_action_fn,
                                                 NULL)

UDS_REGISTER_ECU_RESET_HANDLER(&fixture_uds_instance,
                               ECU_RESET__KEY_OFF_ON,
                               // ecu_reset
                               data_id_check_fn,
                               data_id_action_fn,
                               // do_scheduled_reset
                               data_id_check_fn,
                               data_id_action_fn,
                               NULL)

UDS_REGISTER_MEMORY_DEFAULT_HANDLER(&fixture_uds_instance)

UDS_REGISTER_DIAG_SESSION_CTRL_HANDLER(&fixture_uds_instance,
                                       // diag_session_ctrl
                                       data_id_check_fn,
                                       data_id_action_fn,
                                       // session_timeout
                                       data_id_check_fn,
                                       data_id_action_fn,
                                       NULL)

UDS_REGISTER_READ_DTC_INFO_HANDLER_ALL(&fixture_uds_instance,
                                       data_id_check_fn,
                                       data_id_action_fn,
                                       NULL)

UDS_REGISTER_CLEAR_DIAG_INFO_HANDLER(&fixture_uds_instance,
                                     data_id_check_fn,
                                     data_id_action_fn,
                                     NULL)

UDS_REGISTER_ROUTINE_CONTROL_HANDLER(&fixture_uds_instance,
                                     routine_id,
                                     data_id_check_fn,
                                     data_id_action_fn,
                                     NULL)

UDS_REGISTER_SECURITY_ACCESS_HANDLER(&fixture_uds_instance,
                                     data_id_check_fn,
                                     data_id_action_fn,
                                     data_id_check_fn,
                                     data_id_action_fn,
                                     NULL)

UDS_REGISTER_COMMUNICATION_CONTROL_HANDLER(&fixture_uds_instance,
                                           data_id_check_fn,
                                           data_id_action_fn,
                                           NULL)

UDS_REGISTER_CONTROL_DTC_SETTING_HANDLER(&fixture_uds_instance,
                                         data_id_check_fn,
                                         data_id_action_fn,
                                         NULL)

UDS_REGISTER_LINK_CONTROL_HANDLER(&fixture_uds_instance,
                                  data_id_check_fn,
                                  data_id_action_fn,
                                  NULL)

UDS_REGISTER_AUTHENTICATION_HANDLER(&fixture_uds_instance,
                                    data_id_check_fn,
                                    data_id_action_fn,
                                    data_id_check_fn,
                                    data_id_action_fn,
                                    NULL)

UDS_REGISTER_DYNAMICALLY_DEFINE_DATA_IDS_DEFAULT_HANDLER(&fixture_uds_instance)

static const UDSISOTpCConfig_t default_cfg = {
  // Hardware Addresses
  .source_addr = 0x7E8,  // Can ID Server (us)
  .target_addr = 0x7E0,  // Can ID Client (them)

  // Functional Addresses
  .source_addr_func = 0x7DF,             // ID Server (us)
  .target_addr_func = UDS_TP_NOOP_ADDR,  // ID Client (them)
};

static uint8_t copied_data[4096];
static uint32_t copied_len;

void assert_copy_data_offset(const uint8_t *data,
                             uint32_t len,
                             uint32_t offset) {
  zassert_equal(copied_len, len + offset, "Expected length %u, but got %u", len,
                copied_len);
  zassert_mem_equal(copied_data + offset, data, len);
}

void assert_copy_data(const uint8_t *data, uint32_t len) {
  assert_copy_data_offset(data, len, 0);
}

UDSErr_t receive_event(struct uds_instance_t *inst,
                       UDSEvent_t event,
                       void *args) {
  return inst->iso14229.event_callback(&inst->iso14229, event, args, inst);
}

static uint8_t custom_copy(UDSServer_t *server,
                           const void *data,
                           uint16_t len) {
  memcpy(copied_data + copied_len, data, len);
  copied_len += len;

  return 0;
}

static uint8_t auth_state_data;

void assert_auth_state(uint8_t expected_state) {
  zassert_equal(expected_state, auth_state_data);
}

static uint8_t custom_set_auth_state(UDSServer_t *server, uint8_t state) {
  auth_state_data = state;
  return UDS_OK;
}

static void *uds_setup(void) {
  memset(&fixture_uds_instance, 0, sizeof(fixture_uds_instance));

  static struct lib_uds_fixture fixture = {
    .cfg = default_cfg,
    .can_dev = DEVICE_DT_GET(DT_CHOSEN(zephyr_canbus)),
    .instance = &fixture_uds_instance,
  };

  printk("Using CAN device %s\n", fixture.can_dev->name);

  return &fixture;
}

  FS_LITTLEFS_DECLARE_DEFAULT_CONFIG(lfs_storage);

  static struct fs_mount_t fixture_fs_mount = {
    .type = FS_LITTLEFS,
    .fs_data = &lfs_storage,
    .storage_dev = (void *)PARTITION_ID(storage_partition),
    .mnt_point = "/lfs",
  };

  extern int fixture_fs_wipe(void) {
    const struct flash_area *fa;
    int rc = flash_area_open(PARTITION_ID(storage_partition), &fa);

    if (rc < 0) {
      return rc;
    }

    rc = flash_area_erase(fa, 0, fa->fa_size);
    flash_area_close(fa);

    return rc;
  }

  static void fixture_fs_mount_or_fail(void) {
    fs_unmount(&fixture_fs_mount);

    int rc = fixture_fs_wipe();
    zassert_true(rc >= 0, "flash erase failed (%d)", rc);

    rc = fs_mount(&fixture_fs_mount);
    zassert_equal(rc, 0, "fs_mount failed (%d)", rc);
  }

static void uds_before(void *f) {
  struct lib_uds_fixture *fixture = f;
  const struct device *dev = fixture->can_dev;
  struct uds_instance_t *uds_instance = fixture->instance;

  fixture_fs_mount_or_fail();

  FFF_FAKES_LIST(RESET_FAKE);
  FFF_RESET_HISTORY();

  copy_fake.custom_fake = custom_copy;
  set_auth_state_fake.custom_fake = custom_set_auth_state;

  int ret = uds_init(uds_instance, &default_cfg, dev, fixture);
  assert(ret == 0);

  STRUCT_SECTION_FOREACH (uds_registration_t, reg) {
  }

  test_dynamic_registration_check_invoked = false;
  test_dynamic_registration_action_invoked = false;

  data_id_r_data[0] = 0x12;
  data_id_r_data[1] = 0x34;
  data_id_r_data[2] = 0x56;
  data_id_r_data[3] = 0x78;

  data_id_rw_data[0] = 0x87;
  data_id_rw_data[1] = 0x65;
  data_id_rw_data[2] = 0x43;
  data_id_rw_data[3] = 0x21;

  data_id_rw_duplicated_data[0] = 0x11;
  data_id_rw_duplicated_data[1] = 0x22;
  data_id_rw_duplicated_data[2] = 0x33;
  data_id_rw_duplicated_data[3] = 0x44;

  memset(copied_data, 0, sizeof(copied_data));
  copied_len = 0;

  auth_state_data = 0;
}

static void uds_after(void *f) {
  struct lib_uds_fixture *fixture = f;

  fs_unmount(&fixture_fs_mount);

#ifdef CONFIG_UDS_USE_DYNAMIC_REGISTRATION
  struct uds_registration_t *reg;
  struct uds_registration_t *temp;

  SYS_SLIST_FOR_EACH_CONTAINER_SAFE (&fixture->instance->dynamic_registrations,
                                     reg, temp, node) {
    k_free(reg);
  }

  sys_slist_init(&fixture->instance->dynamic_registrations);
#endif
}

ZTEST_SUITE(lib_uds, NULL, uds_setup, uds_before, uds_after, NULL);
```

## src/fixture.h
```c
/*
 * SPDX-FileCopyrightText: Copyright (C) Frickly Systems GmbH
 * SPDX-FileCopyrightText: Copyright (C) MBition GmbH
 *
 * SPDX-License-Identifier: Apache-2.0
 */

#ifndef APP_TESTS_LIB_ISO14229_SRC_FIXTURE_H_
#define APP_TESTS_LIB_ISO14229_SRC_FIXTURE_H_

#include "ardep/uds.h"

#include <zephyr/drivers/can.h>
#include <zephyr/drivers/can/can_fake.h>
#include <zephyr/fff.h>

#include <ardep/iso14229.h>
#include <iso14229.h>

DECLARE_FAKE_VALUE_FUNC(uint8_t, copy, UDSServer_t *, const void *, uint16_t);

DECLARE_FAKE_VALUE_FUNC(uint8_t, set_auth_state, UDSServer_t *, uint8_t);

DECLARE_FAKE_VALUE_FUNC(UDSErr_t,
                        data_id_check_fn,
                        const struct uds_context *const,
                        bool *);

DECLARE_FAKE_VALUE_FUNC(UDSErr_t,
                        data_id_action_fn,
                        struct uds_context *const,
                        bool *);

DECLARE_FAKE_VALUE_FUNC(UDSErr_t,
                        catchall_check_fn,
                        const struct uds_context *const,
                        bool *);

DECLARE_FAKE_VALUE_FUNC(UDSErr_t,
                        catchall_action_fn,
                        struct uds_context *const,
                        bool *);

extern const uint16_t data_id_r;
extern uint8_t data_id_r_data[4];

extern const uint16_t data_id_rw;
extern uint8_t data_id_rw_data[4];

extern const uint16_t data_id_rw_duplicated1;
extern const uint16_t data_id_rw_duplicated2;
extern uint8_t data_id_rw_duplicated_data[4];

extern const uint16_t routine_id;

extern const uint16_t data_id_unregistered;

#ifdef CONFIG_UDS_USE_DYNAMIC_REGISTRATION
extern bool test_dynamic_registration_check_invoked;
extern bool test_dynamic_registration_action_invoked;
#endif  // # CONFIG_UDS_USE_DYNAMIC_REGISTRATION

struct lib_uds_fixture {
  UDSISOTpCConfig_t cfg;
  struct uds_instance_t *instance;
  const struct device *can_dev;
};

/**
 * @brief Receive an event from iso14229
 */
UDSErr_t receive_event(struct uds_instance_t *inst,
                       UDSEvent_t event,
                       void *args);

/**
 * @brief Assert that the copied data matches the expected data.
 *
 * Beware that the data is in big endian!
 */
void assert_copy_data(const uint8_t *data, uint32_t len);

/**
 * @brief same as `assert_copy_data` but allows to specify an offset
 */
void assert_copy_data_offset(const uint8_t *data,
                             uint32_t len,
                             uint32_t offset);

/**
 * @brief Assert that when using authentication, the correct returnValue is set
 */
void assert_auth_state(uint8_t expected_state);

#endif  // APP_TESTS_LIB_ISO14229_SRC_FIXTURE_H_
```

## src/test_0x10_diag_session_ctrl.c
```c
/*
 * SPDX-FileCopyrightText: Copyright (C) Frickly Systems GmbH
 * SPDX-FileCopyrightText: Copyright (C) MBition GmbH
 *
 * SPDX-License-Identifier: Apache-2.0
 */

#include "ardep/uds.h"
#include "fixture.h"
#include "iso14229.h"
#include "zephyr/ztest_assert.h"

#include <zephyr/ztest.h>

UDSErr_t custom_check_for_0x10_diag_session_ctrl_callback_on_session_change(
    const struct uds_context *const context, bool *apply_action) {
  if (context->registration->type == UDS_REGISTRATION_TYPE__DIAG_SESSION_CTRL &&
      context->event == UDS_EVT_DiagSessCtrl) {
    UDSDiagSessCtrlArgs_t *args = context->arg;
    zassert_equal(args->type, 0x02);
    zassert_equal(args->p2_ms, 0x100);
    zassert_equal(args->p2_star_ms, 0x200);
    *apply_action = true;
  }
  return UDS_OK;
}

ZTEST_F(lib_uds, test_0x10_diag_session_ctrl_callback_on_session_change) {
  struct uds_instance_t *instance = fixture->instance;

  data_id_check_fn_fake.custom_fake =
      custom_check_for_0x10_diag_session_ctrl_callback_on_session_change;

  UDSDiagSessCtrlArgs_t arg = {
    .type = 0x02,  // programming session
    .p2_ms = 0x100,
    .p2_star_ms = 0x200,
  };

  int ret = receive_event(instance, UDS_EVT_DiagSessCtrl, &arg);
  zassert_ok(ret);

  zassert_true(data_id_check_fn_fake.call_count >= 1);
  zassert_equal(data_id_action_fn_fake.call_count, 1);
}

UDSErr_t custom_check_for_0x10_diag_session_ctrl_callback_on_session_timeout(
    const struct uds_context *const context, bool *apply_action) {
  if (context->registration->type == UDS_REGISTRATION_TYPE__DIAG_SESSION_CTRL &&
      context->event == UDS_EVT_SessionTimeout) {
    *apply_action = true;
    zassert_equal_ptr(context->arg, NULL);
  }
  return UDS_OK;
}

ZTEST_F(lib_uds, test_0x10_diag_session_ctrl_callback_on_session_timeout) {
  struct uds_instance_t *instance = fixture->instance;

  data_id_check_fn_fake.custom_fake =
      custom_check_for_0x10_diag_session_ctrl_callback_on_session_timeout;

  int ret = receive_event(instance, UDS_EVT_SessionTimeout, NULL);
  zassert_ok(ret);

  zassert_true(data_id_check_fn_fake.call_count >= 1);
  zassert_equal(data_id_action_fn_fake.call_count, 1);
}
```

## src/test_0x11_ecu_reset.c
```c
/*
 * SPDX-FileCopyrightText: Copyright (C) Frickly Systems GmbH
 * SPDX-FileCopyrightText: Copyright (C) MBition GmbH
 *
 * SPDX-License-Identifier: Apache-2.0
 */

#include "fixture.h"

#include <zephyr/ztest.h>

UDSErr_t custom_check_for_0x11_return_subfunc_not_sup(
    const struct uds_context *const context, bool *apply_action) {
  if (context->registration->type == UDS_REGISTRATION_TYPE__ECU_RESET &&
      context->event == UDS_EVT_EcuReset) {
    UDSECUResetArgs_t *args = context->arg;
    if (args->type == ECU_RESET__KEY_OFF_ON) {
      *apply_action = true;
    }
  }
  return UDS_OK;
}

UDSErr_t custom_action_for_0x11_return_subfunc_not_sup(
    struct uds_context *const context, bool *consume_event) {
  if (context->registration->type == UDS_REGISTRATION_TYPE__ECU_RESET &&
      context->event == UDS_EVT_EcuReset) {
    UDSECUResetArgs_t *args = context->arg;
    if (args->type == ECU_RESET__KEY_OFF_ON) {
      *consume_event = true;
    }
  }
  return UDS_OK;
}

ZTEST_F(lib_uds, test_0x11_ecu_reset_return_subfunc_not_sup) {
  struct uds_instance_t *instance = fixture->instance;

  data_id_check_fn_fake.custom_fake =
      custom_check_for_0x11_return_subfunc_not_sup;
  data_id_action_fn_fake.custom_fake =
      custom_action_for_0x11_return_subfunc_not_sup;

  UDSECUResetArgs_t arg = {
    .type = ECU_RESET__HARD,
    .powerDownTimeMillis = 500,
  };

  int ret = receive_event(instance, UDS_EVT_EcuReset, &arg);
  zassert_equal(ret, UDS_NRC_SubFunctionNotSupported);
}

/////////////////////////////////

UDSErr_t custom_check_for_0x11_ecu_reset_event_works(
    const struct uds_context *const context, bool *apply_action) {
  if (context->registration->type == UDS_REGISTRATION_TYPE__ECU_RESET &&
      context->event == UDS_EVT_EcuReset) {
    UDSECUResetArgs_t *args = context->arg;
    if (args->type == ECU_RESET__KEY_OFF_ON) {
      *apply_action = true;
    }
  }
  return UDS_OK;
}

UDSErr_t custom_action_for_0x11_ecu_reset_event_works(
    struct uds_context *const context, bool *consume_event) {
  if (context->registration->type == UDS_REGISTRATION_TYPE__ECU_RESET &&
      context->event == UDS_EVT_EcuReset) {
    UDSECUResetArgs_t *args = context->arg;
    if (args->type == ECU_RESET__KEY_OFF_ON) {
      *consume_event = true;
    }
  }
  return UDS_OK;
}

ZTEST_F(lib_uds, test_0x11_ecu_reset_ecu_reset_event_works) {
  struct uds_instance_t *instance = fixture->instance;

  data_id_check_fn_fake.custom_fake =
      custom_check_for_0x11_ecu_reset_event_works;
  data_id_action_fn_fake.custom_fake =
      custom_action_for_0x11_ecu_reset_event_works;

  UDSECUResetArgs_t arg = {
    .type = ECU_RESET__KEY_OFF_ON,
    .powerDownTimeMillis = 500,
  };

  int ret = receive_event(instance, UDS_EVT_EcuReset, &arg);
  zassert_ok(ret);

  zassert_true(data_id_check_fn_fake.call_count >= 1);
  zassert_equal(data_id_action_fn_fake.call_count, 1);
}

/////////////////////////////////

UDSErr_t custom_check_for_0x11_do_scheduled_reset_event_works(
    const struct uds_context *const context, bool *apply_action) {
  if (context->registration->type == UDS_REGISTRATION_TYPE__ECU_RESET &&
      context->event == UDS_EVT_DoScheduledReset) {
    if (*(uint32_t *)context->arg == ECU_RESET__KEY_OFF_ON) {
      *apply_action = true;
    }
  }
  return UDS_OK;
}

UDSErr_t custom_action_for_0x11_do_scheduled_reset_event_works(
    struct uds_context *const context, bool *consume_event) {
  if (context->registration->type == UDS_REGISTRATION_TYPE__ECU_RESET &&
      context->event == UDS_EVT_DoScheduledReset) {
    if (*(uint32_t *)context->arg == ECU_RESET__KEY_OFF_ON) {
      *consume_event = true;
    }
  }
  return UDS_OK;
}

ZTEST_F(lib_uds, test_0x11_ecu_reset_do_scheduled_reset_event_works) {
  struct uds_instance_t *instance = fixture->instance;

  data_id_check_fn_fake.custom_fake =
      custom_check_for_0x11_do_scheduled_reset_event_works;
  data_id_action_fn_fake.custom_fake =
      custom_action_for_0x11_do_scheduled_reset_event_works;

  uint32_t reset_type = ECU_RESET__KEY_OFF_ON;
  ;

  int ret = receive_event(instance, UDS_EVT_DoScheduledReset, &reset_type);
  zassert_ok(ret);

  zassert_true(data_id_check_fn_fake.call_count >= 1);
  zassert_equal(data_id_action_fn_fake.call_count, 1);
}
```

## src/test_0x14_clear_diag_info.c
```c
/*
 * SPDX-FileCopyrightText: Copyright (C) Frickly Systems GmbH
 * SPDX-FileCopyrightText: Copyright (C) MBition GmbH
 *
 * SPDX-License-Identifier: Apache-2.0
 */

#include "ardep/uds.h"
#include "fixture.h"
#include "iso14229.h"
#include "zephyr/ztest_assert.h"

#include <zephyr/ztest.h>

UDSErr_t clear_diag_info_0x14_check_fn(const struct uds_context *const context,
                                       bool *apply_action) {
  zassert_equal(context->event, UDS_EVT_ClearDiagnosticInfo);
  zassert_not_null(context->arg);
  *apply_action = true;
  return UDS_OK;
}

UDSErr_t clear_diag_info_0x14_action_fn(struct uds_context *const context,
                                        bool *consume_event) {
  return UDS_OK;
}

ZTEST_F(lib_uds, test_0x14_clear_diag_info) {
  struct uds_instance_t *instance = fixture->instance;

  UDSCDIArgs_t args = {
    .groupOfDTC = 0x00FFDD33,
    .hasMemorySelection = false,
    .memorySelection = 0,
  };

  data_id_check_fn_fake.custom_fake = clear_diag_info_0x14_check_fn;
  data_id_action_fn_fake.custom_fake = clear_diag_info_0x14_action_fn;

  int ret = receive_event(instance, UDS_EVT_ClearDiagnosticInfo, &args);
  zassert_ok(ret);

  zassert_equal(data_id_action_fn_fake.call_count, 1);
}

UDSErr_t clear_diag_info_0x14_action_fn_failure(
    struct uds_context *const context, bool *consume_event) {
  return UDS_NRC_ConditionsNotCorrect;
}

ZTEST_F(lib_uds, test_0x14_clear_diag_info_failure) {
  struct uds_instance_t *instance = fixture->instance;

  UDSCDIArgs_t args = {
    .groupOfDTC = 0x00FFDD33,
    .hasMemorySelection = false,
    .memorySelection = 0,
  };

  data_id_check_fn_fake.custom_fake = clear_diag_info_0x14_check_fn;
  data_id_action_fn_fake.custom_fake = clear_diag_info_0x14_action_fn_failure;

  int ret = receive_event(instance, UDS_EVT_ClearDiagnosticInfo, &args);
  zassert_equal(ret, UDS_NRC_ConditionsNotCorrect);

  zassert_equal(data_id_action_fn_fake.call_count, 1);
}
```

## src/test_0x19_read_dtc_info.c
```c
/*
 * SPDX-FileCopyrightText: Copyright (C) Frickly Systems GmbH
 * SPDX-FileCopyrightText: Copyright (C) MBition GmbH
 *
 * SPDX-License-Identifier: Apache-2.0
 */

#include "fixture.h"

#include <zephyr/ztest.h>

UDSErr_t read_dtc_info_0x01_check_fn(const struct uds_context *const context,
                                     bool *apply_action) {
  zassert_equal(context->event, UDS_EVT_ReadDTCInformation);
  UDSRDTCIArgs_t *args = context->arg;
  zassert_not_null(args);
  zassert_equal(args->type,
                UDS_READ_DTC_INFO_SUBFUNC__NUM_OF_DTC_BY_STATUS_MASK);
  *apply_action = true;
  return UDS_OK;
}

UDSErr_t read_dtc_info_0x01_action_fn(struct uds_context *const context,
                                      bool *consume_event) {
  UDSRDTCIArgs_t *args = context->arg;
  zassert_equal(args->type,
                UDS_READ_DTC_INFO_SUBFUNC__NUM_OF_DTC_BY_STATUS_MASK);

  copy(context->server, (uint8_t[]){0x01, 0x02, 0x03}, 3);

  return UDS_OK;
}

ZTEST_F(lib_uds, test_0x19_read_dtc_info_0x01_num_of_dtc_by_status_mask) {
  struct uds_instance_t *instance = fixture->instance;

  UDSRDTCIArgs_t args = {
    .type = UDS_READ_DTC_INFO_SUBFUNC__NUM_OF_DTC_BY_STATUS_MASK,
    .copy = copy,
  };

  data_id_check_fn_fake.custom_fake = read_dtc_info_0x01_check_fn;
  data_id_action_fn_fake.custom_fake = read_dtc_info_0x01_action_fn;

  int ret = receive_event(instance, UDS_EVT_ReadDTCInformation, &args);
  zassert_ok(ret);

  zassert_equal(data_id_action_fn_fake.call_count, 1);
  assert_copy_data((uint8_t[]){0x01, 0x02, 0x03}, 3);
}

UDSErr_t read_dtc_info_0x02_nrc_check_fn(
    const struct uds_context *const context, bool *apply_action) {
  zassert_equal(context->event, UDS_EVT_ReadDTCInformation);
  UDSRDTCIArgs_t *args = context->arg;
  zassert_not_null(args);
  zassert_equal(args->type, UDS_READ_DTC_INFO_SUBFUNC__DTC_BY_STATUS_MASK);
  *apply_action = true;
  return UDS_OK;
}

UDSErr_t read_dtc_info_0x02_nrc_action_fn(struct uds_context *const context,
                                          bool *consume_event) {
  UDSRDTCIArgs_t *args = context->arg;
  zassert_equal(args->type, UDS_READ_DTC_INFO_SUBFUNC__DTC_BY_STATUS_MASK);

  return UDS_NRC_RequestOutOfRange;
}

ZTEST_F(lib_uds, test_0x19_read_dtc_info_0x02_dtc_by_status_mask_return_nrc) {
  struct uds_instance_t *instance = fixture->instance;

  UDSRDTCIArgs_t args = {
    .type = UDS_READ_DTC_INFO_SUBFUNC__DTC_BY_STATUS_MASK,
    .copy = copy,
  };

  data_id_check_fn_fake.custom_fake = read_dtc_info_0x02_nrc_check_fn;
  data_id_action_fn_fake.custom_fake = read_dtc_info_0x02_nrc_action_fn;

  int ret = receive_event(instance, UDS_EVT_ReadDTCInformation, &args);
  zassert_equal(ret, UDS_NRC_RequestOutOfRange);
}
```

## src/test_0x22_read_data_by_id.c
```c
/*
 * SPDX-FileCopyrightText: Copyright (C) Frickly Systems GmbH
 * SPDX-FileCopyrightText: Copyright (C) MBition GmbH
 *
 * SPDX-License-Identifier: Apache-2.0
 */

#include "fixture.h"

#include <zephyr/ztest.h>

ZTEST_F(lib_uds, test_0x22_read_by_id_fails_when_no_action_applies) {
  struct uds_instance_t *instance = fixture->instance;

  UDSRDBIArgs_t arg = {
    .dataId = data_id_r,
    .copy = copy,
  };

  int ret = receive_event(instance, UDS_EVT_ReadDataByIdent, &arg);
  zassert_equal(ret, UDS_NRC_RequestOutOfRange);
  zassert_true(data_id_check_fn_fake.call_count >= 1);
  zassert_equal(data_id_action_fn_fake.call_count, 0);
}

//////////////////////7

UDSErr_t custom_check_for_0x22_applies_action_when_check_succeeds(
    const struct uds_context *const context, bool *apply_action) {
  if (context->registration->type == UDS_REGISTRATION_TYPE__DATA_IDENTIFIER &&
      context->registration->data_identifier.data_id == data_id_r &&
      context->event == UDS_EVT_ReadDataByIdent) {
    *apply_action = true;
  }
  return UDS_OK;
}

ZTEST_F(lib_uds, test_0x22_read_by_id_applies_action_when_check_succeeds) {
  struct uds_instance_t *instance = fixture->instance;

  data_id_check_fn_fake.custom_fake =
      custom_check_for_0x22_applies_action_when_check_succeeds;

  UDSRDBIArgs_t arg = {
    .dataId = data_id_r,
    .copy = copy,
  };

  int ret = receive_event(instance, UDS_EVT_ReadDataByIdent, &arg);
  zassert_ok(ret);

  zassert_true(data_id_check_fn_fake.call_count >= 1);
  zassert_equal(data_id_action_fn_fake.call_count, 1);
}

//////////////////////7

UDSErr_t custom_check_for_0x22_both_actions_are_executed(
    const struct uds_context *const context, bool *apply_action) {
  if (context->registration->type == UDS_REGISTRATION_TYPE__DATA_IDENTIFIER &&
      context->registration->data_identifier.data_id ==
          data_id_rw_duplicated1 &&
      context->event == UDS_EVT_ReadDataByIdent) {
    *apply_action = true;
  }
  return UDS_OK;
}

UDSErr_t custom_action_for_0x22_both_actions_are_executed(
    struct uds_context *const context, bool *consume_event) {
  if (context->registration->type == UDS_REGISTRATION_TYPE__DATA_IDENTIFIER &&
      context->registration->data_identifier.data_id ==
          data_id_rw_duplicated1 &&
      context->event == UDS_EVT_ReadDataByIdent) {
    *consume_event = false;
  }
  return UDS_OK;
}

ZTEST_F(lib_uds, test_0x22_read_by_id_both_actions_are_executed) {
  struct uds_instance_t *instance = fixture->instance;

  data_id_check_fn_fake.custom_fake =
      custom_check_for_0x22_both_actions_are_executed;
  data_id_action_fn_fake.custom_fake =
      custom_action_for_0x22_both_actions_are_executed;

  UDSRDBIArgs_t arg = {
    .dataId = data_id_rw_duplicated1,
    .copy = copy,
  };

  int ret = receive_event(instance, UDS_EVT_ReadDataByIdent, &arg);
  zassert_ok(ret);

  zassert_true(data_id_check_fn_fake.call_count >= 1);
  zassert_equal(data_id_action_fn_fake.call_count, 2);
}

//////////////////////7
UDSErr_t custom_check_for_0x22_returns_action_returncode(
    const struct uds_context *const context, bool *apply_action) {
  if (context->registration->type == UDS_REGISTRATION_TYPE__DATA_IDENTIFIER &&
      context->registration->data_identifier.data_id == data_id_r &&
      context->event == UDS_EVT_ReadDataByIdent) {
    *apply_action = true;
  }
  return UDS_OK;
}

UDSErr_t custom_action_for_0x22_returns_action_returncode(
    struct uds_context *const context, bool *consume_event) {
  if (context->registration->type == UDS_REGISTRATION_TYPE__DATA_IDENTIFIER &&
      context->registration->data_identifier.data_id == data_id_r &&
      context->event == UDS_EVT_ReadDataByIdent) {
    *consume_event = false;
    return UDS_NRC_SecurityAccessDenied;
  }
  return UDS_OK;
}

ZTEST_F(lib_uds, test_0x22_read_by_id_returns_action_returncode) {
  struct uds_instance_t *instance = fixture->instance;

  data_id_check_fn_fake.custom_fake =
      custom_check_for_0x22_returns_action_returncode;
  data_id_action_fn_fake.custom_fake =
      custom_action_for_0x22_returns_action_returncode;

  UDSRDBIArgs_t arg = {
    .dataId = data_id_r,
    .copy = copy,
  };

  int ret = receive_event(instance, UDS_EVT_ReadDataByIdent, &arg);
  zassert_equal(ret, UDS_NRC_SecurityAccessDenied);

  zassert_true(data_id_check_fn_fake.call_count >= 1);
  zassert_equal(data_id_action_fn_fake.call_count, 1);
}
//////////////////////7
#ifdef CONFIG_UDS_USE_DYNAMIC_REGISTRATION

#define UDS_UNIQUE_DATA_ID 0xFEEF

UDSErr_t custom_check_for_0x22_dynamic_registration(
    const struct uds_context *const context, bool *apply_action) {
  if (context->registration->type == UDS_REGISTRATION_TYPE__DATA_IDENTIFIER &&
      context->registration->data_identifier.data_id == UDS_UNIQUE_DATA_ID &&
      context->event == UDS_EVT_ReadDataByIdent) {
    test_dynamic_registration_check_invoked = true;
    *apply_action = true;
  }
  return UDS_OK;
}

UDSErr_t custom_action_for_0x22_dynamic_registration(
    struct uds_context *const context, bool *consume_event) {
  if (context->registration->type == UDS_REGISTRATION_TYPE__DATA_IDENTIFIER &&
      context->registration->data_identifier.data_id == UDS_UNIQUE_DATA_ID &&
      context->event == UDS_EVT_ReadDataByIdent) {
    consume_event = false;
    test_dynamic_registration_action_invoked = true;
  }
  return UDS_OK;
}

ZTEST_F(lib_uds, test_0x22_read_by_id_dynamic_registration) {
  struct uds_instance_t *instance = fixture->instance;

  struct uds_registration_t reg;
  reg.type = UDS_REGISTRATION_TYPE__DATA_IDENTIFIER;
  reg.data_identifier.data_id = UDS_UNIQUE_DATA_ID;
  reg.data_identifier.read.check = custom_check_for_0x22_dynamic_registration;
  reg.data_identifier.read.action = custom_action_for_0x22_dynamic_registration;
  reg.data_identifier.write.check = NULL;
  reg.data_identifier.write.action = NULL;

  uint32_t reg_id;
  int ret = instance->register_event_handler(instance, reg, &reg_id, NULL);
  zassert_ok(ret);

  UDSRDBIArgs_t arg = {
    .dataId = UDS_UNIQUE_DATA_ID,
    .copy = copy,
  };

  ret = receive_event(instance, UDS_EVT_ReadDataByIdent, &arg);
  zassert_ok(ret);

  zassert_true(test_dynamic_registration_check_invoked);
  zassert_true(test_dynamic_registration_action_invoked);
}

//////////////////////7

ZTEST_F(lib_uds,
        test_0x22_read_by_id_dynamic_registration_with_no_read_fn_smoke_test) {
  struct uds_instance_t *instance = fixture->instance;

  struct uds_registration_t reg;
  reg.type = UDS_REGISTRATION_TYPE__DATA_IDENTIFIER;
  reg.data_identifier.data_id = UDS_UNIQUE_DATA_ID;
  reg.data_identifier.read.check = NULL;
  reg.data_identifier.read.action = NULL;
  reg.data_identifier.write.check = NULL;
  reg.data_identifier.write.action = NULL;

  uint32_t reg_id;
  int ret = instance->register_event_handler(instance, reg, &reg_id, NULL);
  zassert_ok(ret);

  UDSRDBIArgs_t arg = {
    .dataId = UDS_UNIQUE_DATA_ID,
    .copy = copy,
  };

  ret = receive_event(instance, UDS_EVT_ReadDataByIdent, &arg);
  zassert_equal(ret, UDS_NRC_RequestOutOfRange);
}
//////////////////////7

#endif  // CONFIG_UDS_USE_DYNAMIC_REGISTRATION
```

## src/test_0x27_security_access.c
```c
/*
 * SPDX-FileCopyrightText: Copyright (C) Frickly Systems GmbH
 * SPDX-FileCopyrightText: Copyright (C) MBition GmbH
 *
 * SPDX-License-Identifier: Apache-2.0
 */

#include "ardep/uds.h"
#include "fixture.h"
#include "iso14229.h"
#include "zephyr/ztest_assert.h"

#include <zephyr/ztest.h>

UDSErr_t security_access_0x27_request_seed_check_fn(
    const struct uds_context *const context, bool *apply_action) {
  zassert_equal(context->event, UDS_EVT_SecAccessRequestSeed);
  zassert_not_null(context->arg);

  UDSSecAccessRequestSeedArgs_t *args = context->arg;

  zassert_equal(args->level, 1);
  zassert_equal(args->len, 0);
  zassert_is_null(args->dataRecord);

  *apply_action = true;
  return UDS_OK;
}

UDSErr_t security_access_0x27_request_seed_action_fn(
    struct uds_context *const context, bool *consume_event) {
  UDSSecAccessRequestSeedArgs_t *args = context->arg;

  uint8_t seed[] = {0x11, 0x22};
  return args->copySeed(context->server, seed, sizeof(seed));
}

ZTEST_F(lib_uds, test_0x27_security_access_request_seed) {
  struct uds_instance_t *instance = fixture->instance;

  UDSSecAccessRequestSeedArgs_t args = {
    .level = 1,
    .len = 0,
    .dataRecord = NULL,
    .copySeed = copy,
  };

  data_id_check_fn_fake.custom_fake =
      security_access_0x27_request_seed_check_fn;
  data_id_action_fn_fake.custom_fake =
      security_access_0x27_request_seed_action_fn;

  int ret = receive_event(instance, UDS_EVT_SecAccessRequestSeed, &args);
  zassert_ok(ret);

  uint8_t response_data[] = {0x11, 0x22};
  assert_copy_data(response_data, sizeof(response_data));

  zassert_equal(data_id_action_fn_fake.call_count, 1);
}

UDSErr_t security_access_0x27_validate_key_check_fn(
    const struct uds_context *const context, bool *apply_action) {
  zassert_equal(context->event, UDS_EVT_SecAccessValidateKey);
  zassert_not_null(context->arg);

  UDSSecAccessValidateKeyArgs_t *args = context->arg;

  zassert_equal(args->level, 1);
  zassert_equal(args->len, 2);
  uint8_t key[] = {0xEE, 0xDD};
  zassert_mem_equal(args->key, key, args->len);

  *apply_action = true;
  return UDS_OK;
}

UDSErr_t security_access_0x27_validate_key_action_fn(
    struct uds_context *const context, bool *consume_event) {
  return UDS_PositiveResponse;
}

ZTEST_F(lib_uds, test_0x27_security_access_validate_key) {
  struct uds_instance_t *instance = fixture->instance;

  uint8_t key[] = {0xEE, 0xDD};
  UDSSecAccessValidateKeyArgs_t args = {
    .level = 1,
    .len = 2,
    .key = key,
  };

  data_id_check_fn_fake.custom_fake =
      security_access_0x27_validate_key_check_fn;
  data_id_action_fn_fake.custom_fake =
      security_access_0x27_validate_key_action_fn;

  int ret = receive_event(instance, UDS_EVT_SecAccessValidateKey, &args);
  zassert_ok(ret);

  zassert_equal(data_id_action_fn_fake.call_count, 1);
}
```

## src/test_0x28_comm_control.c
```c
/*
 * SPDX-FileCopyrightText: Copyright (C) Frickly Systems GmbH
 * SPDX-FileCopyrightText: Copyright (C) MBition GmbH
 *
 * SPDX-License-Identifier: Apache-2.0
 */

#include "ardep/uds.h"
#include "fixture.h"
#include "iso14229.h"
#include "zephyr/ztest_assert.h"

#include <zephyr/ztest.h>

UDSErr_t comm_control_0x28_check_fn(const struct uds_context *const context,
                                    bool *apply_action) {
  zassert_equal(context->event, UDS_EVT_CommCtrl);
  zassert_not_null(context->arg);

  *apply_action = true;
  return UDS_OK;
}

UDSErr_t comm_control_0x28_action_fn(struct uds_context *const context,
                                     bool *consume_event) {
  UDSCommCtrlArgs_t *args = context->arg;

  if (args->commType == 0x01) {
    zassert_equal(args->ctrlType, 3);

    return UDS_PositiveResponse;
  }

  zassert_equal(args->ctrlType, 5);
  zassert_equal(args->nodeId, 0x000A);
  return UDS_NRC_ConditionsNotCorrect;
}

ZTEST_F(lib_uds, test_comm_control_0x28) {
  struct uds_instance_t *instance = fixture->instance;

  UDSCommCtrlArgs_t args = {
    .commType = 0x01,
    .ctrlType = 0x03,
  };

  data_id_check_fn_fake.custom_fake = comm_control_0x28_check_fn;
  data_id_action_fn_fake.custom_fake = comm_control_0x28_action_fn;

  int ret = receive_event(instance, UDS_EVT_CommCtrl, &args);
  zassert_ok(ret);

  zassert_equal(data_id_action_fn_fake.call_count, 1);
}

ZTEST_F(lib_uds, test_comm_control_0x28_neg_resp) {
  struct uds_instance_t *instance = fixture->instance;

  UDSCommCtrlArgs_t args = {
    .commType = 0x04,
    .ctrlType = 0x05,
    .nodeId = 0x000A,
  };

  data_id_check_fn_fake.custom_fake = comm_control_0x28_check_fn;
  data_id_action_fn_fake.custom_fake = comm_control_0x28_action_fn;

  int ret = receive_event(instance, UDS_EVT_CommCtrl, &args);
  zassert_equal(ret, UDS_NRC_ConditionsNotCorrect);

  zassert_equal(data_id_action_fn_fake.call_count, 1);
}
```
