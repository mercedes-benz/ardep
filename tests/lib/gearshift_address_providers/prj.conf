## CMakeLists.txt
```
# SPDX-FileCopyrightText: Copyright (C) Frickly Systems GmbH
# SPDX-FileCopyrightText: Copyright (C) MBition GmbH
#
# SPDX-License-Identifier: Apache-2.0

cmake_minimum_required(VERSION 3.20.0)

find_package(Zephyr REQUIRED HINTS $ENV{ZEPHYR_BASE})

project(test_gearshift_address_providers)

FILE(GLOB app_sources src/*.c)
target_sources(app PRIVATE ${app_sources})
```

## prj.conf
```kconfig
CONFIG_ZTEST=y
CONFIG_ASSERT=y

CONFIG_GPIO=y
CONFIG_GEARSHIFT=y
CONFIG_GEARSHIFT_ADDRESS_PROVIDERS=y
CONFIG_GEARSHIFT_CAN_LOG_ADDRESS_PROVIDER=y
CONFIG_GEARSHIFT_UDS_ADDRESS_PROVIDER=y
CONFIG_GEARSHIFT_CAN_LOG_ADDRESS_PROVIDER_BASE_ID=0x100
CONFIG_GEARSHIFT_UDS_ADDRESS_PROVIDER_BASE_PHYS_SA=0x7E8
CONFIG_GEARSHIFT_UDS_ADDRESS_PROVIDER_BASE_PHYS_TA=0x7E0

CONFIG_CAN=y
CONFIG_CAN_FAKE=y
CONFIG_LOG=y
CONFIG_LOG_MODE_DEFERRED=y
CONFIG_CAN_LOG=y
CONFIG_CAN_LOG_AUTOSTART_BUS=y

CONFIG_UDS=y
CONFIG_UDS_DEFAULT_INSTANCE=y

CONFIG_STD_C17=y
```

## boards/native_sim.overlay
```dts
/*
 * SPDX-FileCopyrightText: Copyright (C) Frickly Systems GmbH
 * SPDX-FileCopyrightText: Copyright (C) MBition GmbH
 *
 * SPDX-License-Identifier: Apache-2.0
 */

/ {
	can_fake: can_fake {
		compatible = "zephyr,fake-can";
		status = "okay";
	};

	chosen {
		zephyr,canbus = &can_fake;
	};

	/* ACTIVE_HIGH so gpio_emul_input_set maps 1:1 to the encoded value. */
	gearshift: gearshift {
		compatible = "zephyr,binary-encoded-gpio";
		input-gpios = <&gpio0 0 GPIO_ACTIVE_HIGH>,
			      <&gpio0 1 GPIO_ACTIVE_HIGH>,
			      <&gpio0 2 GPIO_ACTIVE_HIGH>;
		status = "okay";
	};
};

/delete-node/ &can0;
```

## src/main.c
```c
/*
 * SPDX-FileCopyrightText: Copyright (C) Frickly Systems GmbH
 * SPDX-FileCopyrightText: Copyright (C) MBition GmbH
 *
 * SPDX-License-Identifier: Apache-2.0
 */

#include <zephyr/device.h>
#include <zephyr/drivers/gpio.h>
#include <zephyr/drivers/gpio/gpio_emul.h>
#include <zephyr/ztest.h>

#include <ardep/can_log.h>
#include <ardep/uds.h>

static const struct device *gpio0 = DEVICE_DT_GET(DT_NODELABEL(gpio0));

/*
 * The gearshift is a zephyr,binary-encoded-gpio node: pins 0..2 of gpio0 carry
 * the position as a 3-bit little-endian number, so positions 0..7 are possible.
 * There is no gearshift hardware on native_sim, so drive the pins through the
 * GPIO emulator to stand in for it.
 */
static void set_gearshift_position(uint8_t pos)
{
	zassert_equal(gpio_emul_input_set(gpio0, 0, (pos >> 0) & 1), 0);
	zassert_equal(gpio_emul_input_set(gpio0, 1, (pos >> 1) & 1), 0);
	zassert_equal(gpio_emul_input_set(gpio0, 2, (pos >> 2) & 1), 0);
}

static void *gearshift_setup(void)
{
	zassert_true(device_is_ready(gpio0), "gpio0 not ready");
	return NULL;
}

/* Start every test from position 0 so a previous test cannot leak state. */
static void gearshift_before(void *f)
{
	ARG_UNUSED(f);
	set_gearshift_position(0);
}

ZTEST_SUITE(lib_gearshift_address_providers, NULL, gearshift_setup, gearshift_before,
	    NULL, NULL);

/*
 * The CAN log provider derives its ID as base + gearshift position, so each ECU
 * on the bus logs under a distinct ID. Sweep the low, an arbitrary middle and
 * the highest encodable position to confirm the offset is applied as-is and not
 * clamped or masked somewhere.
 */
ZTEST(lib_gearshift_address_providers, test_can_log_id_offsets)
{
	set_gearshift_position(0);
	zassert_equal(can_log_get_id(),
		      CONFIG_GEARSHIFT_CAN_LOG_ADDRESS_PROVIDER_BASE_ID);

	set_gearshift_position(2);
	zassert_equal(can_log_get_id(),
		      CONFIG_GEARSHIFT_CAN_LOG_ADDRESS_PROVIDER_BASE_ID + 2);

	set_gearshift_position(7);
	zassert_equal(can_log_get_id(),
		      CONFIG_GEARSHIFT_CAN_LOG_ADDRESS_PROVIDER_BASE_ID + 7);
}

/*
 * The UDS provider offsets both physical addresses by the same position, while
 * the functional addresses stay unused. Checking the functional pair matters as
 * much as the physical one: the provider must not accidentally offset them.
 */
ZTEST(lib_gearshift_address_providers, test_uds_address_offsets)
{
	set_gearshift_position(2);

	UDSISOTpCConfig_t cfg = uds_default_instance_get_addresses();

	zassert_equal(cfg.source_addr,
		      CONFIG_GEARSHIFT_UDS_ADDRESS_PROVIDER_BASE_PHYS_SA + 2);
	zassert_equal(cfg.target_addr,
		      CONFIG_GEARSHIFT_UDS_ADDRESS_PROVIDER_BASE_PHYS_TA + 2);
	zassert_equal(cfg.source_addr_func, UDS_TP_NOOP_ADDR);
	zassert_equal(cfg.target_addr_func, UDS_TP_NOOP_ADDR);
}
```
