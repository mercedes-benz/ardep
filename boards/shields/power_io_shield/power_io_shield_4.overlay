/*
 * Copyright (C) Frickly Systems GmbH
 * Copyright (C) MBition GmbH
 *
 * SPDX-License-Identifier: Apache-2.0
 */

#include <ardep/dt-bindings/power-io-shield.h>

&i2c2 {
	status = "okay";

	power_io_shield4: power_io_shield4@24 {
		compatible = "power-io-shield";
		int-gpios = <&gpioe 2 (GPIO_ACTIVE_LOW|GPIO_PULL_UP)>, <&gpioe 5 (GPIO_ACTIVE_LOW|GPIO_PULL_UP)>;
		reg = <0x24>;
		gpio-controller;
		#gpio-cells = <2>;
	};
};
