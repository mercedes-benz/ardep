/*
 * Copyright (c) 2024 Frickly Systems GmbH
 *
 * SPDX-License-Identifier: Apache-2.0
*/


uart_b: &usart2 {
    pinctrl-0 = <&usart2_tx_pd5 &usart2_rx_pd6>;
    pinctrl-names = "default";
    current-speed = <115200>;
    status = "okay";
};

uart_a: &uart4 {
    pinctrl-0 = <&uart4_tx_pc10 &uart4_rx_pc11>;
    pinctrl-names = "default";
    current-speed = <115200>;
    status = "okay";
};
