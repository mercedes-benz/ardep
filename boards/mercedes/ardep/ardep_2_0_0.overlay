/*
 * SPDX-FileCopyrightText: Copyright (c) 2019 STMicroelectronics.
 * SPDX-FileCopyrightText: Copyright (C) Frickly Systems GmbH
 * SPDX-FileCopyrightText: Copyright (C) MBition GmbH
 *
 * SPDX-License-Identifier: Apache-2.0
 */

/ {
    model = "Automotive Rapid Development board v2.0.0";
};
