/*
 * SPDX-FileCopyrightText: Copyright (c) 2019 STMicroelectronics.
 * SPDX-FileCopyrightText: Copyright (C) Frickly Systems GmbH
 * SPDX-FileCopyrightText: Copyright (C) MBition GmbH
 *
 * SPDX-License-Identifier: Apache-2.0
 */

/ {
    model = "Automotive Rapid Development board v1.0.0";

    chosen {
        zephyr,console = &usb_cdc_acm;
        zephyr,shell-uart = &usb_cdc_acm;
    };
};

&usb {
    status = "okay";

    usb_cdc_acm: usb-cdc-acm {
        status = "okay";
        compatible = "zephyr,cdc-acm-uart";
    };
};
