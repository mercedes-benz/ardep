## Kconfig
```kconfig
# Copyright (C) Frickly Systems GmbH
# Copyright (C) MBition GmbH
#
# SPDX-License-Identifier: Apache-2.0


rsource "drivers/Kconfig"
rsource "lib/Kconfig"
```

## boards/arm/ardep/Kconfig.board
```kconfig
# Copyright (C) Frickly Systems GmbH
# Copyright (C) MBition GmbH
#
# SPDX-License-Identifier: Apache-2.0

# ARDEP Board configuration

config BOARD_ARDEP
	bool "Automotive Rapid Development Platform (ARDEP)"
	depends on SOC_STM32G474XX
```

## boards/arm/ardep/Kconfig.defconfig
```kconfig
# Copyright (c) 2024 Frickly Systems GmbH
# SPDX-License-Identifier: Apache-2.0

# ARDEP board configuration

if BOARD_ARDEP

config BOARD
	default "ardep"

config SPI_STM32_INTERRUPT
	default y
	depends on SPI

config CAN_TERMINATION_GPIO
	default y if CAN

# adc 1 and 2 use the same, but the other use diffent interrupts
# shared interrupts currently seem to be broken for a mixed of shared
# and non-shared interrupts
config ADC_STM32_SHARED_IRQS
	default n

config CAN_MAX_FILTER
	default 8

rsource "Kconfig.usb"
rsource "Kconfig.usb_dfu"

if !MCUBOOT
	# enable building for image slots
	config BOOTLOADER_MCUBOOT
		default y
	config FLASH_MAP
		default y

	rsource "Kconfig.uds"

	config MCUBOOT_SIGNATURE_KEY_FILE
		default "bootloader/mcuboot/root-rsa-2048.pem"
endif # !MCUBOOT

endif # BOARD_ARDEP
```

## boards/arm/ardep/Kconfig.uds
```kconfig
# Copyright (c) 2024 Frickly Systems GmbH
# SPDX-License-Identifier: Apache-2.0

# enable UDS module per default

config UDS
 	default y
config CAN
	default y
config ISOTP
	default y

config FLASH
    default y

config STREAM_FLASH
    default y

config IMG_MANAGER
    default y

config IMG_ERASE_PROGRESSIVELY
    default y

config REBOOT
    default y
```

## boards/arm/ardep/Kconfig.usb
```kconfig
# Copyright (c) 2024 Frickly Systems GmbH
# SPDX-License-Identifier: Apache-2.0

# enable USB per default

config USB_DEVICE_STACK
    default y

config USB_DEVICE_VID
    default 0x25E1

config USB_DEVICE_PID
    default 0x1B1E

config USB_DEVICE_INITIALIZE_AT_BOOT
    default y if !MCUBOOT

config USB_DEVICE_PRODUCT
    default "ARDEP Board"

config USB_CDC_ACM
    default y

choice USB_CDC_ACM_LOG_LEVEL_CHOICE
    default USB_CDC_ACM_LOG_LEVEL_OFF
endchoice
```

## boards/mercedes/ardep/Kconfig.ardep
```kconfig
# Copyright (C) Frickly Systems GmbH
# Copyright (C) MBition GmbH
#
# SPDX-License-Identifier: Apache-2.0

# ARDEP Board configuration

config BOARD_ARDEP
	bool "Automotive Rapid Development Platform (ARDEP)"
	select SOC_STM32G474XX
```

## boards/mercedes/ardep/Kconfig.defconfig
```kconfig
# Copyright (C) Frickly Systems GmbH
# Copyright (C) MBition GmbH
#
# SPDX-License-Identifier: Apache-2.0

# ARDEP board configuration

if BOARD_ARDEP

config BOARD
	default "ardep"

config SPI_STM32_INTERRUPT
	default y
	depends on SPI

config CAN_MAX_FILTER
	default 8
		
rsource "Kconfig.usb"

# These options are only relevant if we don't build MCUBOOT.
# We need this as we don't always build with sysbuild which sets these automatically
if !MCUBOOT
	# enable building for image slots
	config BOOTLOADER_MCUBOOT
		default y
	config FLASH_MAP
		default y

	rsource "Kconfig.uds"

	config MCUBOOT_GENERATE_UNSIGNED_IMAGE
		default y
endif # !MCUBOOT

config RETAINED_MEM
	default y

config RETENTION
	default y

config RETENTION_BOOT_MODE
	default y

endif # BOARD_ARDEP
```

## boards/mercedes/ardep/Kconfig.sysbuild
```kconfig
# Copyright (C) Frickly Systems GmbH
# Copyright (C) MBition GmbH
#
# SPDX-License-Identifier: Apache-2.0

# Note that this is config inside sysbuild and is thus prefixed with SB_CONFIG_
# Configuration for other sysbuild targets (i.e. mcuboot) is located in ./sysbuild.cmake

choice BOOTLOADER
  default BOOTLOADER_MCUBOOT
endchoice
choice BOOT_SIGNATURE_TYPE
  default BOOT_SIGNATURE_TYPE_NONE
endchoice

choice MCUBOOT_MODE
  default MCUBOOT_MODE_FIRMWARE_UPDATER
endchoice
```

## boards/mercedes/ardep/Kconfig.uds
```kconfig
# Copyright (C) Frickly Systems GmbH
# Copyright (C) MBition GmbH
#
# SPDX-License-Identifier: Apache-2.0

# enable UDS module per default

config UDS
    default y

# Provide UDS Address via gearshift address providers
# Only enable if UDS is really enabled
if UDS
    config GEARSHIFT_UDS_ADDRESS_PROVIDER
        default y
endif # UDS

choice STD_C
    default STD_C17 # requirement for external iso14229 module
endchoice

config CAN
    default y
```

## boards/mercedes/ardep/Kconfig.usb
```kconfig
# Copyright (C) Frickly Systems GmbH
# Copyright (C) MBition GmbH
#
# SPDX-License-Identifier: Apache-2.0

# lower log level of usb device stack to reduce log spam
choice USBD_LOG_LEVEL_CHOICE
  default USBD_LOG_LEVEL_ERR
endchoice

choice UDC_DRIVER_LOG_LEVEL_CHOICE
  default UDC_DRIVER_LOG_LEVEL_ERR
endchoice

choice USBD_CDC_ACM_LOG_LEVEL_CHOICE
  default USBD_CDC_ACM_LOG_LEVEL_OFF
endchoice
```

## boards/mercedes/ardep/Kconfig.usb_dfu
```kconfig
# Copyright (C) Frickly Systems GmbH
# Copyright (C) MBition GmbH
#
# SPDX-License-Identifier: Apache-2.0

# enable USB DFU per default

config USB_DEVICE_DFU_PID
    default 0x1B1E

config USB_DFU_WILL_DETACH
    default y

config USB_DFU_CLASS
    default y
    
config USB_DFU_PERMANENT_DOWNLOAD
    default y

config USB_DFU_ENABLE_UPLOAD
    default y

config FLASH
    default y

config FLASH_MAP
    default y

config STREAM_FLASH
    default y

config IMG_MANAGER
    default y

config FLASH_PAGE_LAYOUT
    default y

if !MCUBOOT
    config USB_DFU_REBOOT
        default y
endif # !MCUBOOT
```

## boards/mercedes/ardep/ardep_1_0_0_defconfig
```kconfig
# Copyright (C) Frickly Systems GmbH
# Copyright (C) MBition GmbH
#
# SPDX-License-Identifier: Apache-2.0

CONFIG_USB_DEVICE_STACK=y
CONFIG_USB_DEVICE_INITIALIZE_AT_BOOT=y
CONFIG_USB_CDC_ACM=y
CONFIG_USB_CDC_ACM_LOG_LEVEL_OFF=y

CONFIG_USB_DFU_WILL_DETACH=y
CONFIG_USB_DFU_CLASS=y
CONFIG_USB_DFU_PERMANENT_DOWNLOAD=y
CONFIG_USB_DFU_ENABLE_UPLOAD=y
CONFIG_FLASH=y
CONFIG_FLASH_MAP=y
CONFIG_STREAM_FLASH=y
CONFIG_IMG_MANAGER=y
CONFIG_FLASH_PAGE_LAYOUT=y

CONFIG_USB_DFU_REBOOT=y
```

## boards/mercedes/ardep/ardep_defconfig
```kconfig
# Copyright (C) Frickly Systems GmbH
# Copyright (C) MBition GmbH
#
# SPDX-License-Identifier: Apache-2.0

# enable uart driver
CONFIG_SERIAL=y

# enable GPIO
CONFIG_GPIO=y

# Enable Clocks
CONFIG_CLOCK_CONTROL=y

# Console
CONFIG_CONSOLE=y
CONFIG_UART_CONSOLE=y

# Enable Segger RTT
CONFIG_USE_SEGGER_RTT=y
CONFIG_RTT_CONSOLE=y

# Enable MPU
CONFIG_ARM_MPU=y

# Enable HW stack protection
CONFIG_HW_STACK_PROTECTION=y

# enable pin controller
CONFIG_PINCTRL=y

# Default USB name, VID and PID
CONFIG_USB_DEVICE_PRODUCT="ARDEP Board"
CONFIG_USB_DEVICE_VID=0x25E1
CONFIG_USB_DEVICE_PID=0x1B1E
CONFIG_USB_DEVICE_DFU_PID=0x1B1E
```

## boards/mercedes/ardep/board.yml
```yaml
board:
  name: ardep
  vendor: mercedes
  revision:
    format: major.minor.patch
    default: "2.0.0"
    revisions:
      - name: "1.0.0"
      - name: "2.0.0"
  socs:
    - name: stm32g474xx
```

## boards/shields/hv_shield/Kconfig.defconfig
```kconfig
if SHIELD_HV_SHIELD
  config GPIO
    default y
  
  config SPI
    default y

  config HV_SHIELD
    default y
  
  config HV_SHIELD_GPIO
    default y

  config DAC
    default y
  
  config HV_SHIELD_DAC
    default y
endif
```

## boards/shields/power_io_shield/Kconfig.defconfig
```kconfig
# Copyright (C) Frickly Systems GmbH
# Copyright (C) MBition GmbH
#
# SPDX-License-Identifier: Apache-2.0

if SHIELD_POWER_IO_SHIELD
  config GPIO
    default y

  config I2C
    default y

  config POWER_IO_SHIELD
    default y
endif
```

## boards/shields/power_io_shield/Kconfig.shield
```kconfig
# Copyright (C) Frickly Systems GmbH
# Copyright (C) MBition GmbH
#
# SPDX-License-Identifier: Apache-2.0

config SHIELD_POWER_IO_SHIELD
  def_bool $(shields_list_contains,power_io_shield) || \
           $(shields_list_contains,power_io_shield_0) || \
           $(shields_list_contains,power_io_shield_1) || \
           $(shields_list_contains,power_io_shield_2) || \
           $(shields_list_contains,power_io_shield_3) || \
           $(shields_list_contains,power_io_shield_4) || \
           $(shields_list_contains,power_io_shield_5) || \
           $(shields_list_contains,power_io_shield_6) || \
           $(shields_list_contains,power_io_shield_7)
```

## drivers/Kconfig
```kconfig
# Copyright (C) Frickly Systems GmbH
# Copyright (C) MBition GmbH
#
# SPDX-License-Identifier: Apache-2.0

menu "Drivers"
rsource "can/Kconfig"
rsource "hv_shield/Kconfig"
rsource "power_io_shield/Kconfig"
rsource "lin/Kconfig"
endmenu
```

## drivers/can/Kconfig
```kconfig
# Copyright (C) Frickly Systems GmbH
# Copyright (C) MBition GmbH
#
# SPDX-License-Identifier: Apache-2.0

menu "CAN Drivers"
  menuconfig LIN2CAN
    depends on CAN
    depends on ABSTRACT_LIN
    bool "Enable LIN2CAN Driver"

  if LIN2CAN
    rsource "lin2can/Kconfig"
  endif

endmenu
```

## drivers/can/lin2can/Kconfig
```kconfig
# Copyright (C) Frickly Systems GmbH
# Copyright (C) MBition GmbH
#
# SPDX-License-Identifier: Apache-2.0

module = LIN2CAN
module-str = LIN2CAN
source "subsys/logging/Kconfig.template.log_config"


config LIN2CAN_INIT_PRIORITY
  int
  prompt "LIN2CAN init priority"
  default CAN_INIT_PRIORITY

config LIN2CAN_OUTGOING_QUEUE_SIZE
  int 
  prompt "Outgoing queue size"
  default 32
  help 
    The size of the outgoing message queue. If can_send is executed and the queue is full
    it will block until there is room in the queue (or a timeout ocurrs)


config LIN2CAN_MASTER_REQUEST_ID
  hex
  prompt "Master request LIN ID"
  default 0x3C

config LIN2CAN_SLAVE_RESPONSE_ID
  hex
  prompt "Slave response LIN ID"
  default 0x3D

menu "Translated CAN IDs"
  config LIN2CAN_CAN_ID0
    hex
    prompt "LIN ID 0"
    default 0x80
  config LIN2CAN_CAN_ID1
    hex
    prompt "LIN ID 1"
    default 0x180
  config LIN2CAN_CAN_ID2
    hex
    prompt "LIN ID 2"
    default 0x01
  config LIN2CAN_CAN_ID3
    hex
    prompt "LIN ID 3"
    default 0x181
endmenu
```

## drivers/hv_shield/Kconfig
```kconfig
menuconfig HV_SHIELD
  bool
  prompt "HV Shield Driver"
  depends on GPIO && SPI

if HV_SHIELD
  rsource "hv_shield/Kconfig"

  menuconfig HV_SHIELD_GPIO
    bool
    prompt "HV Shield GPIO Driver"
    depends on HV_SHIELD

  if HV_SHIELD_GPIO
    rsource "gpio/Kconfig"
  endif

  menuconfig HV_SHIELD_DAC
    bool
    prompt "HV Shield DAC Driver"
    depends on HV_SHIELD && DAC
  
  if HV_SHIELD_DAC
    rsource "dac/Kconfig"
  endif
endif
```

## drivers/hv_shield/dac/Kconfig
```kconfig
config HV_SHIELD_DAC_INIT_PRIORITY
  int
  prompt "HV Shield DAC Init Priority"
  default HV_SHIELD_INIT_PRIORITY
```

## drivers/hv_shield/gpio/Kconfig
```kconfig
config HV_SHIELD_GPIO_INIT_PRIORITY
  int
  prompt "GPIO init priority"
  default HV_SHIELD_INIT_PRIORITY
```
