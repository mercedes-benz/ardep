## drivers/hv_shield/hv_shield/Kconfig
```kconfig
module = HV_SHIELD
module-str = HV Shield
source "subsys/logging/Kconfig.template.log_config"

config HV_SHIELD_INIT_PRIORITY
  int
  prompt "HV Shield init priority"
  default SPI_INIT_PRIORITY
```

## drivers/lin/Kconfig
```kconfig
# Copyright (C) Frickly Systems GmbH
# Copyright (C) MBition GmbH
#
# SPDX-License-Identifier: Apache-2.0

if LIN
menu "LIN Drivers"
menuconfig ABSTRACT_LIN
  bool "Enable Abstract LIN Driver"

if ABSTRACT_LIN
rsource "abstract_lin/Kconfig"
endif

endmenu
endif
```

## drivers/lin/abstract_lin/Kconfig
```kconfig
# Copyright (C) Frickly Systems GmbH
# Copyright (C) MBition GmbH
#
# SPDX-License-Identifier: Apache-2.0

module = ABSTRACT_LIN
module-str = Abstract LIN
source "subsys/logging/Kconfig.template.log_config"

config ABSTRACT_LIN_MAX_FRAME_COUNT
  int
  prompt "Max registerable frame count per driver"
  default 4
  range 0 64

config ABSTRACT_LIN_INIT_PRIORITY
  int
  default LIN_INIT_PRIORITY
  prompt "Init priority of Abstract LIN driver"


menuconfig ABSTRACT_LIN_SCHEDULER
  bool
  prompt "Enable scheduler support"

if ABSTRACT_LIN_SCHEDULER
  config ABSTRACT_LIN_SCHEDULER_PRIORITY
    int
    prompt "Scheduler thread priority"
    default 0 if !COOP_ENABLED
    default -1
    depends on ABSTRACT_LIN_SCHEDULER

  config ABSTRACT_LIN_SCHEDULER_STACK_SIZE
    int
    prompt "Scheduler thread stack size"
    default 2048
    depends on ABSTRACT_LIN_SCHEDULER
endif
```

## drivers/power_io_shield/Kconfig
```kconfig
# Copyright (C) Frickly Systems GmbH
# Copyright (C) MBition GmbH
#
# SPDX-License-Identifier: Apache-2.0

menuconfig POWER_IO_SHIELD
  bool
  prompt "Power IO Shield Driver"
  depends on GPIO && I2C

if POWER_IO_SHIELD
  module = POWER_IO_SHIELD
  module-str = Power IO Shield
  source "subsys/logging/Kconfig.template.log_config"

  config POWER_IO_SHIELD_INIT_PRIORITY
    int
    prompt "Power IO Shield init priority"
    default I2C_INIT_PRIORITY

  config EMUL_POWER_IO_SHIELD
    bool
    prompt "Power IO Shield Emulator"
    depends on EMUL
    default n
endif
```

## dts/bindings/abstract-lin/lin2can.yaml
```yaml
# Copyright (C) Frickly Systems GmbH
# Copyright (C) MBition GmbH

description: |
  Creates a virtual can interface that converts can messages to lin messages

compatible: "virtual,lin2can"

include: base.yaml

# must be on abstract lin bus
on-bus: abstract-lin
```

## dts/bindings/can/can-termination-gpio.yaml
```yaml
# Copyright (C) Frickly Systems GmbH
# Copyright (C) MBition GmbH


description: |
  This binding is used to configure the CAN termination GPIOs.

compatible: "can-termination-gpio"

include: base.yaml

properties:
  enable-gpios:
    type: phandle-array
    required: true
    description: |
      GPIO to use to enable/disable the CAN termination. This GPIO is driven
      active when the CAN termination is enabled and inactive when the CAN
      termination is disabled.
  enable-on-boot:
    type: boolean
    description: |
      If true, the CAN termination is enabled at boot time. If false, the CAN
      termination is disabled at boot time.
      If this property is not present, the CAN termination is disabled at boot
      time.
```

## dts/bindings/dac/hv-shield-dac.yaml
```yaml
description: Subode of HV shield main node for DACs

compatible: hv-shield-dac

on-bus: hv-shield

properties:
  io-channels:
    description: The 2 low voltage DACs on the STM32
    type: phandles
    required: true

  io-channels-channel:
    description: Channel numbers for the DACs
    type: array
    required: true

  gains:
    description: The 2 gains for each of the two DACs
    type: array
    required: true

  "#io-channel-cells":
    type: int
    const: 0
```

## dts/bindings/gpio/hv-shield-gpio.yaml
```yaml
description: HV shield gpio binding

compatible: "hv-shield-gpio"

include: [gpio-controller.yaml, base.yaml]

on-bus: hv-shield

properties:
  low-voltage-gpios:
    type: phandle-array
    required: true

  "#gpio-cells":
    const: 2

gpio-cells:
  - pin
  - flags
```

## dts/bindings/gpio/power-io-shield.yaml
```yaml
description: Power IO shield gpio driver binding

compatible: "power-io-shield"

include: [gpio-controller.yaml, i2c-device.yaml]

properties:
  "#gpio-cells":
    const: 2

  int-gpios:
    required: false
    description: "GPIOs used for power io shield interrupts. Can be shared across multiple power io shields"
    type: "phandle-array"

gpio-cells:
  - pin
  - flags
```

## dts/bindings/lin/abstract-lin.yaml
```yaml
# Copyright (c) 2024 Frickly Systems GmbH
# SPDX-License-Identifier: Apache-2.0

description: |
  Creates a virtual lin abstraction device to simplify concurrent lin usage

compatible: "virtual,abstract-lin"

include: base.yaml

# must be on lin bus
on-bus: lin

# creates a virtual lin bus
bus: abstract-lin

properties:
  type:
    type: string
    description: Type of LIN Node. Responder can only respond to received headers, commanders can initiate frames.
    enum:
      - "LIN_MODE_COMMANDER"
      - "LIN_MODE_RESPONDER"
```

## dts/bindings/spi/hv-shield.yaml
```yaml
description: HV shield main node binding. Controls gains. Subnodes are for gpios, adcs and dacs

compatible: "hv-shield"

include: spi-device.yaml

# only hv-shield drivers should be subnodes
bus: hv-shield

properties:
  oe-gpios:
    description: The gpio line driving OE for shift registers
    type: phandle-array
    required: true
```

## lib/Kconfig
```kconfig
# Copyright (C) Frickly Systems GmbH
# Copyright (C) MBition GmbH
#
# SPDX-License-Identifier: Apache-2.0

menu "ARDEP"
    rsource "ardep_usb/Kconfig"
    rsource "can_router/Kconfig"
    rsource "iso14229/Kconfig"
    rsource "uds/Kconfig"
    rsource "uds_legacy/Kconfig"
    rsource "can_log/Kconfig"
    rsource "gearshift_address_providers/Kconfig"
endmenu
```

## lib/ardep_usb/Kconfig
```kconfig
# Copyright (C) Frickly Systems GmbH
# Copyright (C) MBition GmbH
#
# SPDX-License-Identifier: Apache-2.0

menuconfig ARDEP_USB
    bool "ARDEP USB device stack"
    depends on BOARD_ARDEP
    default n if MCUBOOT # disable for bootloader builds
    default y if BOARD_ARDEP && !MCUBOOT
    select USBD_DFU
    select USB_DEVICE_STACK_NEXT
    select REBOOT
    help
      Enable USB device stack with DFU support for ARDEP boards. This provides a handler for DFU Detach
      commands that reboots the device into the firmware loader, allowing firmware updates via USB.

if ARDEP_USB
  module = ARDEP_USB
  module-str = "ARDEP USB stack"
  source "subsys/logging/Kconfig.template.log_config"

  config ARDEP_USB_PRODUCT_STRING
    string "USB product string"
    default "ARDEP USB"
endif
```

## lib/can_log/Kconfig
```kconfig
# Copyright (C) Frickly Systems GmbH
# Copyright (C) MBition GmbH
#
# SPDX-License-Identifier: Apache-2.0

menuconfig CAN_LOG
    bool "CAN Log Backend"
    depends on CAN
    depends on LOG
    # this currently only works with deferred or immediate log mode
    depends on LOG_MODE_DEFERRED || LOG_MODE_IMMEDIATE
    # todo: default n
    default y
    help
        Enable CAN logging backend. This backend sends log messages as raw CAN Frames on a specified CAN Identifier.
        It works best in Deferred mode with LOG_PROCESS_THREAD configuration enabled.


if CAN_LOG
    module = CAN_LOG
    module-str = CAN Logger
    source "subsys/logging/Kconfig.template.log_config"

    config CAN_LOG_ID
        hex
        prompt "CAN Log ID"
        default 0x100
        help
          CAN identifier used for logging messages.

    config CAN_LOG_AUTOSTART_BUS
        bool "Auto-start CAN bus for logging"
        default n
        help
          If enabled, the CAN bus used for logging will be automatically
          started during CAN log backend initialization.

    if CAN_LOG_AUTOSTART_BUS
        config CAN_LOG_AUTOSTART_BUS_PRIORITY
            int
            prompt "CAN Log Auto-start Bus Priority"
            default CAN_INIT_PRIORITY
            help
              Priority used when starting the CAN bus for logging.
    endif # CAN_LOG_AUTOSTART_BUS
endif
```

## lib/can_router/Kconfig
```kconfig
# Copyright (C) Frickly Systems GmbH
# Copyright (C) MBition GmbH
#
# SPDX-License-Identifier: Apache-2.0

menuconfig CAN_ROUTER
    bool "Can frame router"
    depends on CAN
    help
        Route can frames from one can device to another using filters

if CAN_ROUTER

    module = CAN_ROUTER
    module-str = CAN Router
    source "subsys/logging/Kconfig.template.log_config"

    config CAN_ROUTER_INIT_PRIORITY
      int
      prompt "CAN Router Init priority"
      default APPLICATION_INIT_PRIORITY
      depends on CAN_ROUTER

endif # CAN_ROUTER
```

## lib/iso14229/Kconfig
```kconfig
# Copyright (C) Frickly Systems GmbH
# Copyright (C) MBition GmbH
#
# SPDX-License-Identifier: Apache-2.0

menuconfig ISO14229
    bool "UDS Minimal support"
    default n
    imply MODULE_ISO14229_EXTERNAL
    
if ISO14229

    module = ISO14229
    module-str = iso14229
    source "subsys/logging/Kconfig.template.log_config"
    
    menuconfig ISO14229_THREAD
        bool "Enable ISO14229 thread"
        default y
        help
          Enable this option to run the ISO14229 protocol in its own thread.
          This is recommended for most applications.
          
        if ISO14229_THREAD
    
            config ISO14229_THREAD_STACK_SIZE
                int "ISO14229 thread stack size"
                default 1024
                help
                  Stack size for the ISO14229 thread. In this thread, all incoming CAN
                  messages and events are handled.    
                  
        endif # ISO14229_THREAD

    config ISO14229_THREAD_SLEEP_US
        int "ISO14229 thread sleep time"
        default 1000
        help
          Sleep time for the ISO14229 thread in microseconds. In this thread, all incoming CAN
          messages and events are handled. A lower value means lower latency,
          but higher CPU usage.

endif # ISO14229
```

## lib/uds/Kconfig
```kconfig
# Copyright (C) Frickly Systems GmbH
# Copyright (C) MBition GmbH
#
# SPDX-License-Identifier: Apache-2.0

menuconfig UDS
    bool "UDS"
    select ISO14229
    imply REBOOT

if UDS 

    module = UDS
    module-str = UDS
    source "subsys/logging/Kconfig.template.log_config"

    config UDS_USE_DYNAMIC_REGISTRATION
        bool "Allow registering new event handlers at runtime"
        default n

    menuconfig UDS_UPLOAD_DOWNLOAD_MODULE
        bool "module to allow uploading and downloading of big chunks for data"
        select FLASH
        select FLASH_MAP
        default y

    if UDS_UPLOAD_DOWNLOAD_MODULE

        config UDS_FILE_TRANSFER
            bool "feature of upload download module that allows file transfer"
            depends on FILE_SYSTEM
            default y

        config UDS_UPLOAD_MAX_PAYLOAD_SIZE
            int "Maximum TransferData payload size for upload"
            default 128
            help
                Maximum size of each TransferData payload during upload.
                This value can also be limited by other factors, this is just a user-specified maximum

    endif # UDS_UPLOAD_DOWNLOAD_MODULE

    menuconfig UDS_USE_LINK_CONTROL
        bool "Enable LinkControl service (0x87)"
        default n
        help
          Enable support for the LinkControl service (0x87). This service allows
          switching the CAN bitrate at runtime.
          
    if UDS_USE_LINK_CONTROL

        config UDS_DEFAULT_CAN_BITRATE
            int "Default CAN bitrate"
            default 500000
            help
              Default CAN bitrate for UDS communication. When using the LinkControl
              function and the can interface gets reset to its default bitrate,
              this value is used.
    
    endif # UDS_USE_LINK_CONTROL
endif # UDS
```

## lib/uds_legacy/Kconfig
```kconfig
# Copyright (C) Frickly Systems GmbH
# Copyright (C) MBition GmbH
#
# SPDX-License-Identifier: Apache-2.0

menuconfig UDS_LEGACY
    bool "UDS legacy library"
    depends on CAN
    depends on ISOTP

    depends on CAN_MAX_FILTER >= 8

    depends on BOOTLOADER_MCUBOOT
    depends on IMG_MANAGER
    depends on REBOOT

if UDS_LEGACY

    module = UDS_LEGACY
    module-str = uds_legacy
    source "subsys/logging/Kconfig.template.log_config"

endif
```

## lib/uds_minimal/Kconfig
```kconfig
# Copyright (C) Frickly Systems GmbH
# Copyright (C) MBition GmbH
#
# SPDX-License-Identifier: Apache-2.0

menuconfig UDS_MINIMAL
    bool "UDS Minimal support"
    depends on ISO14229_LIB
    
if UDS_MINIMAL

module = UDS_MINIMAL
module-str = UDS minimal
source "subsys/logging/Kconfig.template.log_config"

endif # UDS_MINIMAL
```

## lib/uds_new/Kconfig
```kconfig
# Copyright (C) Frickly Systems GmbH
# Copyright (C) MBition GmbH
#
# SPDX-License-Identifier: Apache-2.0

menuconfig UDS_NEW
    bool "UDS New"
    select ISO14229
    select REBOOT
    
if UDS_NEW

module = UDS_NEW
module-str = UDS new
source "subsys/logging/Kconfig.template.log_config"

config UDS_NEW_USE_DYNAMIC_REGISTRATION
    bool "Allow registering new event handlers at runtime"
    default n

endif # UDS_NEW
```

## modules/iso14229/Kconfig
```kconfig
# Copyright (C) Frickly Systems GmbH
# Copyright (C) MBition GmbH
#
# SPDX-License-Identifier: Apache-2.0

menuconfig MODULE_ISO14229_EXTERNAL
  bool "ISO14229 Library"
  default n
  depends on CAN
	depends on STD_C11 || STD_C17 || STD_C23

if MODULE_ISO14229_EXTERNAL

  module = MODULE_ISO14229_EXTERNAL
  module-str = External ISO14229 Library
  source "subsys/logging/Kconfig.template.log_config"

endif
```

## samples/can/Kconfig
```kconfig
# Copyright (C) Frickly Systems GmbH
# Copyright (C) MBition GmbH
#
# SPDX-License-Identifier: Apache-2.0

mainmenu "CAN sample application"

config CAN_EXAMPLE_FRAME_ID
	int "frame id to be used in the example"
	default 101

config CAN_EXAMPLE_USE_CAN_FD
	bool "build the example with FD support"
	select CAN_FD_MODE
	default n


menu "Zephyr"
source "Kconfig.zephyr"
endmenu

module = APP
module-str = APP
source "subsys/logging/Kconfig.template.log_config"
```

## samples/can/sample.yaml
```yaml
# Copyright (C) Frickly Systems GmbH
# Copyright (C) MBition GmbH

# This file is provided so that the application can be compiled using Twister,
# the Zephyr testing tool. In this file, multiple combinations can be specified,
# so that you can easily test all of them locally or in CI.
sample:
  description: can example
  name: can-example
common:
  build_only: true
  integration_platforms:
    - nucleo_g474re
    - ardep
tests:
  example.can.can: {}
  example.can.can_fd:
    extra_overlay_confs:
      - fd.conf
```

## samples/config_jumpers/sample.yaml
```yaml
# Copyright (C) Frickly Systems GmbH
# Copyright (C) MBition GmbH

sample:
  name: config_jumpers example
common:
  build_only: true
  integration_platforms:
    - ardep
tests:
  example.config_jumpers.default: {}
```

## samples/digital_input_interrupt/sample.yaml
```yaml
# Copyright (C) Frickly Systems GmbH
# Copyright (C) MBition GmbH

sample:
  name: interrupt example
common:
  build_only: true
  integration_platforms:
    - nucleo_g474re
    - ardep
tests:
  example.gpio_interrupt.default: {}
```
