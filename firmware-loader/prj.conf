## CMakeLists.txt
```
# SPDX-FileCopyrightText: Copyright (C) Frickly Systems GmbH
# SPDX-FileCopyrightText: Copyright (C) MBition GmbH
#
# SPDX-License-Identifier: Apache-2.0

cmake_minimum_required(VERSION 3.20.0)

find_package(Zephyr REQUIRED HINTS $ENV{ZEPHYR_BASE})
project(firmware-loader)

file(GLOB SRC_FILES src/*.c)
target_sources(app PRIVATE ${SRC_FILES})
```

## Kconfig
```
# Copyright (C) Frickly Systems GmbH
# Copyright (C) MBition GmbH
#
# SPDX-License-Identifier: Apache-2.0

mainmenu "Firmware Loader"

comment "UDS Firmware Loader Configuration"

menu "Firmware Loader Settings"

module = APP
module-str = app
source "subsys/logging/Kconfig.template.log_config"

comment "UDS Addresses"

config FIRMWARE_LOADER_PHYS_SA
    hex "Physical Source Address"
    default 0x7E8
    help
      The physical source address used for UDS communication.
      Should be the same as the main application's address

config FIRMWARE_LOADER_PHYS_TA
    hex "Physical Target Address"
    default 0x7E0
    help
      The physical target address used for UDS communication.
      Should be the same as the main application's address

config FIRMWARE_LOADER_FUNC_SA
    hex "Functional Source Address"
    default 0x7DF
    help
      The functional source address used for UDS communication.
      Should be the same as the main application's address

endmenu

comment "Zephyr Configuration"

source "Kconfig.zephyr"
```

## sample.yaml
```
# Copyright (C) Frickly Systems GmbH
# Copyright (C) MBition GmbH
#
# SPDX-License-Identifier: Apache-2.0

sample:
  name: firmware-loader
common:
  build_only: true
  integration_platforms:
    - ardep
tests:
  firmware-loader.default: {}
```

## prj.conf
```kconfig
# Console and UART configuration
CONFIG_CONSOLE=y
CONFIG_SERIAL=y
CONFIG_UART_CONSOLE=y

# Logging configuration
CONFIG_LOG=y
CONFIG_LOG_DEFAULT_LEVEL=3
CONFIG_APP_LOG_LEVEL_INF=y

# UDS
CONFIG_CAN=y
CONFIG_CAN_MAX_FILTER=12
CONFIG_UDS=y
CONFIG_STD_C11=y
CONFIG_UDS_LOG_LEVEL_DBG=y

CONFIG_UDS_UPLOAD_DOWNLOAD_MODULE=y
```

## app.overlay
```dts
/ {
    chosen {
		  zephyr,code-partition = &slot1_partition;
	};
};
```

## boards/ardep.overlay
```dts
/ {
    chosen {
      zephyr,code-partition = &slot1_partition;
      zephyr,console = &uart_a;
      zephyr,shell-uart = &uart_a;
  };
};
```

## src/main.c
```c
/*
 * SPDX-FileCopyrightText: Copyright (C) Frickly Systems GmbH
 * SPDX-FileCopyrightText: Copyright (C) MBition GmbH
 *
 * SPDX-License-Identifier: Apache-2.0
 */

#include <zephyr/logging/log.h>
LOG_MODULE_REGISTER(firmware_loader, CONFIG_APP_LOG_LEVEL);

#include "uds.h"

#include <zephyr/device.h>
#include <zephyr/kernel.h>
#include <zephyr/logging/log.h>
#include <zephyr/retention/retention.h>

#include <ardep/iso14229.h>
#include <ardep/uds.h>

const struct device *retention_data =
    DEVICE_DT_GET(DT_CHOSEN(zephyr_firmware_loader_args));

const struct device *can_dev = DEVICE_DT_GET(DT_CHOSEN(zephyr_canbus));

struct uds_instance_t instance;

UDS_REGISTER_ECU_DEFAULT_HARD_RESET_HANDLER(&instance);

int main() {
  LOG_INF("Hello firmware-loader");

  uint8_t session_type;

  int ret = retention_read(retention_data, 0, &session_type, 1);
  if (ret != 0) {
    LOG_ERR("Failed to read from retention 1: %d", ret);
    return ret;
  }
  LOG_INF("Read stored session type from retention data: %02x", session_type);

  LOG_INF("Configuring UDS...");

  UDSISOTpCConfig_t cfg = {
    // Hardware Addresses
    .source_addr = 0x7E8,
    .target_addr = 0x7E0,

    // Functional Addresses
    .source_addr_func = 0x7DF,
    .target_addr_func = UDS_TP_NOOP_ADDR,
  };

  uds_init(&instance, &cfg, can_dev, NULL);

  if (!device_is_ready(can_dev)) {
    LOG_INF("CAN device not ready");
    return -ENODEV;
  }

  int err = can_set_mode(can_dev, CAN_MODE_NORMAL);
  if (err) {
    LOG_ERR("Failed to set CAN mode: %d", err);
    return err;
  }

  if (session_type == UDS_DIAG_SESSION__PROGRAMMING) {
    LOG_INF("Injecting DiagnosticSessionControl (Programming) frame");
    struct can_frame frame = {
      .id = cfg.source_addr,
      .dlc = 3,
      .flags = 0,
    };
    frame.data[0] = 0x02;  // PCI (single frame, 2 bytes of data)
    frame.data[1] = 0x10;  // SID (DiagnosticSessionControl)
    frame.data[2] = 0x02;  // DS  (Programming Session)

    iso14229_inject_can_frame_rx(&instance.iso14229, &frame);
  }

  err = can_start(can_dev);
  if (err) {
    LOG_ERR(
        "Failed to start CAN device: "
        "%d",
        err);
    return err;
  }
  LOG_INF("CAN device started");

  instance.iso14229.thread_start(&instance.iso14229);
  LOG_INF("UDS thread started");
}
```

## src/main.h
```c
#include <ardep/uds.h>

extern struct uds_instance_t instance;
```

## src/uds.h
```c
/*
 * SPDX-FileCopyrightText: Copyright (C) 2025 Frickly Systems GmbH
 * SPDX-FileCopyrightText: Copyright (C) 2025 MBition GmbH
 *
 * SPDX-License-Identifier: Apache-2.0
 */

#include <ardep/uds.h>

extern struct uds_instance_t instance;
```

## src/uds_routine_control.c
```c
/*
 * SPDX-FileCopyrightText: Copyright (C) Frickly Systems GmbH
 * SPDX-FileCopyrightText: Copyright (C) MBition GmbH
 *
 * SPDX-License-Identifier: Apache-2.0
 */

#include "iso14229.h"

#include <zephyr/logging/log.h>
LOG_MODULE_DECLARE(firmware_loader, CONFIG_APP_LOG_LEVEL);

#include "uds.h"

#include <zephyr/init.h>
#include <zephyr/kernel.h>
#include <zephyr/storage/flash_map.h>
#include <zephyr/sys/byteorder.h>
#include <zephyr/sys/reboot.h>
#include <zephyr/sys/util.h>

#include <ardep/uds.h>

enum uds_memory_erasure_routine_state {
  UDS_MEMORY_ERASURE_STATE__NOT_STARTED = 0,
  UDS_MEMORY_ERASURE_STATE__IN_PROGRESS = 1,
  UDS_MEMORY_ERASURE_STATE__COMPLETED = 2,
};

struct uds_memory_erasure_routine_status {
  enum uds_memory_erasure_routine_state state;
  struct k_mutex *mutex;
  int32_t result;
  struct k_work_delayable work;
};

K_MUTEX_DEFINE(memory_erasure_routine_mutex);

static void erase_slot0_work_handler(struct k_work *work);

static struct uds_memory_erasure_routine_status erasure_status = {
  .state = UDS_MEMORY_ERASURE_STATE__NOT_STARTED,
  .result = UDS_OK,
  .mutex = &memory_erasure_routine_mutex,
};

static int erase_memory_routine_init(void) {
  k_work_init_delayable(&erasure_status.work, erase_slot0_work_handler);
  return 0;
}

SYS_INIT(erase_memory_routine_init,
         APPLICATION,
         CONFIG_APPLICATION_INIT_PRIORITY);

static void erase_slot0_work_handler(struct k_work *work) {
  struct k_work_delayable *dwork = k_work_delayable_from_work(work);
  struct uds_memory_erasure_routine_status *status =
      CONTAINER_OF(dwork, struct uds_memory_erasure_routine_status, work);

  const struct flash_area *fa;
  int rc = flash_area_open(FIXED_PARTITION_ID(slot0_partition), &fa);

  int32_t result = UDS_OK;

  if (rc < 0) {
    LOG_ERR("Failed to open slot0 partition: %d", rc);
    result = UDS_NRC_GeneralProgrammingFailure;
  } else {
    LOG_INF("Erasing slot0 partition at 0x%08x, size: %zu bytes",
            (uint32_t)fa->fa_off, fa->fa_size);

    rc = flash_area_erase(fa, 0, fa->fa_size);

    if (rc < 0) {
      LOG_ERR("Failed to erase slot0 partition: %d", rc);
    } else {
      LOG_INF("Successfully erased slot0 partition");
    }

    flash_area_close(fa);
  }

  k_mutex_lock(status->mutex, K_FOREVER);
  status->result = result;
  status->state = UDS_MEMORY_ERASURE_STATE__COMPLETED;
  k_mutex_unlock(status->mutex);
}

UDSErr_t erase_memory_routine_check(const struct uds_context *const context,
                                    bool *apply_action) {
  LOG_INF("Routine Control CHECK");
  UDSRoutineCtrlArgs_t *args = (UDSRoutineCtrlArgs_t *)context->arg;

  struct uds_memory_erasure_routine_status *status =
      (struct uds_memory_erasure_routine_status *)
          context->registration->routine_control.user_context;

  if (args->ctrlType == UDS_ROUTINE_CONTROL__START_ROUTINE &&
      status->state == UDS_MEMORY_ERASURE_STATE__IN_PROGRESS) {
    LOG_WRN("Memory erasure routine already in progress");
    *apply_action = false;
    return UDS_NRC_RequestSequenceError;
  }

  if (args->ctrlType == UDS_ROUTINE_CONTROL__REQUEST_ROUTINE_RESULTS &&
      status->state != UDS_MEMORY_ERASURE_STATE__COMPLETED) {
    LOG_WRN("Memory erasure routine not completed yet");
    *apply_action = false;
    return UDS_NRC_RequestSequenceError;
  }

  if (args->ctrlType == UDS_ROUTINE_CONTROL__STOP_ROUTINE) {
    *apply_action = false;
    LOG_WRN("Stop routine not supported");
    return UDS_NRC_SubFunctionNotSupported;
  }

  *apply_action = true;
  LOG_INF("Routine Control CHECK finished");
  return UDS_OK;
}

UDSErr_t erase_memory_routine_action(struct uds_context *const context,
                                     bool *consume_event) {
  LOG_INF("Routine Control Action");
  UDSRoutineCtrlArgs_t *args = (UDSRoutineCtrlArgs_t *)context->arg;

  struct uds_memory_erasure_routine_status *status =
      (struct uds_memory_erasure_routine_status *)
          context->registration->routine_control.user_context;

  *consume_event = true;

  // only support flash erase for now
  if (args->id != 0xFF00) {
    LOG_WRN("Unsupported routine ID: 0x%04x", args->id);
    *consume_event = false;
    return UDS_NRC_RequestOutOfRange;
  }

  switch (args->ctrlType) {
    case UDS_ROUTINE_CONTROL__START_ROUTINE: {
      k_mutex_lock(status->mutex, K_FOREVER);
      status->state = UDS_MEMORY_ERASURE_STATE__IN_PROGRESS;
      status->result = UDS_OK;
      k_mutex_unlock(status->mutex);

      // Submit the work item to erase slot0 with a 150ms delay
      // So the response (if requested) can be sent first
      k_work_schedule(&status->work, K_MSEC(150));

      LOG_INF("Memory erasure routine started");
      return UDS_PositiveResponse;
    }
    case UDS_ROUTINE_CONTROL__REQUEST_ROUTINE_RESULTS: {
      k_mutex_lock(status->mutex, K_FOREVER);
      enum uds_memory_erasure_routine_state current_state = status->state;
      int32_t result = status->result;
      k_mutex_unlock(status->mutex);

      if (current_state != UDS_MEMORY_ERASURE_STATE__COMPLETED) {
        LOG_WRN("Memory erasure routine not completed yet");
        return UDS_NRC_RequestSequenceError;
      }
      LOG_INF("Memory erasure routine requested result: 0x%02x", result);

      int32_t be_result = sys_cpu_to_be32(result);
      return args->copyStatusRecord(context->server, &be_result,
                                    sizeof(be_result));
    }
    default:
      LOG_WRN("Unsupported control type: 0x%02x", args->ctrlType);
      *consume_event = false;
      return UDS_NRC_SubFunctionNotSupported;
  }
}

UDS_REGISTER_ROUTINE_CONTROL_HANDLER(&instance,
                                     0xFF00,
                                     erase_memory_routine_check,
                                     erase_memory_routine_action,
                                     &erasure_status);
```

## src/uds_session.c
```c
/*
 * SPDX-FileCopyrightText: Copyright (C) Frickly Systems GmbH
 * SPDX-FileCopyrightText: Copyright (C) MBition GmbH
 *
 * SPDX-License-Identifier: Apache-2.0
 */

#include <zephyr/logging/log.h>

LOG_MODULE_DECLARE(firmware_loader, CONFIG_APP_LOG_LEVEL);

#include "uds.h"

#include <zephyr/logging/log_ctrl.h>
#include <zephyr/sys/reboot.h>
#include <zephyr/sys/util.h>

#include <ardep/uds.h>
#include <sys/cdefs.h>

UDSErr_t on_session_ctrl_check(const struct uds_context *const context,
                               bool *apply_action) {
  // We want to handle all events
  *apply_action = true;
  return UDS_OK;
}

UDSErr_t on_session_ctrl_action(struct uds_context *const context,
                                bool *consume_event) {
  UDSDiagSessCtrlArgs_t *args = (UDSDiagSessCtrlArgs_t *)context->arg;

  // There are no other event handlers registered
  *consume_event = true;

  switch (args->type) {
    case UDS_DIAG_SESSION__PROGRAMMING:
      LOG_INF("Switching to programming session");
      return UDS_OK;
    case UDS_DIAG_SESSION__EXTENDED:
      LOG_INF("Switching to extended session");
      return UDS_OK;
  }

  LOG_WRN("Unsupported session type: 0x%02x", args->type);
  return UDS_NRC_SubFunctionNotSupported;
}

UDSErr_t on_session_timeout_check(const struct uds_context *const context,
                                  bool *apply_action) {
  // We want to handle all events
  *apply_action = true;
  return UDS_OK;
}

UDSErr_t on_session_timeout_action(struct uds_context *const context,
                                   bool *consume_event) {
  LOG_INF("Reboot due to session timeout failed!");

  // Flush logs
  log_flush();

  sys_reboot(SYS_REBOOT_COLD);
  // We should never reach this point
  CODE_UNREACHABLE;
}

UDS_REGISTER_DIAG_SESSION_CTRL_HANDLER(&instance,
                                       on_session_ctrl_check,
                                       on_session_ctrl_action,
                                       on_session_timeout_check,
                                       on_session_timeout_action,
                                       NULL);
```
